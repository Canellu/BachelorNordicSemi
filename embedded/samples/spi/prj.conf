## prj.conf
```kconfig
CONFIG_SPI=y
CONFIG_MAIN_STACK_SIZE=4096
CONFIG_SPI_1=y
```

## boards/nrf9160dk_nrf9160ns.overlay
```dts
&uart1 {
	status = "disabled";
};

&spi1 {
	compatible = "nordic,nrf-spim";
	status = "okay";
	sck-pin = <10>;
	mosi-pin = <11>;
	miso-pin = <12>;
};
```

## src/main.c
```c
/*
* Copyright (c) 2012-2014 Wind River Systems, Inc.
*
* SPDX-License-Identifier: Apache-2.0
*/

#include <zephyr.h>
#include <sys/printk.h>
#include <drivers/spi.h>

static struct spi_cs_control spi_cs_ctrl = {
	.delay = 0,
	.gpio_pin = 13,
	.gpio_dt_flags = GPIO_ACTIVE_LOW,
};

static struct spi_config spi_cfg = {
	.operation = SPI_OP_MODE_MASTER | SPI_WORD_SET(8) | SPI_TRANSFER_MSB |
				 SPI_MODE_CPOL | SPI_MODE_CPHA,
	.frequency = 4000000,
	.slave = 0,
	.cs = &spi_cs_ctrl,
};

const struct device *spi_dev;

static void spi_init(void)
{
	const char *const spiName = "SPI_1";
	spi_dev = device_get_binding(spiName);

	if (spi_dev == NULL)
	{
		printk("Could not get %s device\n", spiName);
		return;
	}
	spi_cs_ctrl.gpio_dev = device_get_binding("GPIO_0");
}

void spi_test_send(void)
{
	int err;
	static uint8_t tx_buffer[1];
	static uint8_t rx_buffer[1];

	const struct spi_buf tx_buf = {
		.buf = tx_buffer,
		.len = sizeof(tx_buffer)};
	const struct spi_buf_set tx = {
		.buffers = &tx_buf,
		.count = 1};

	struct spi_buf rx_buf = {
		.buf = rx_buffer,
		.len = sizeof(rx_buffer),
	};
	const struct spi_buf_set rx = {
		.buffers = &rx_buf,
		.count = 1};

	err = spi_transceive(spi_dev, &spi_cfg, &tx, &rx);
	if (err)
	{
		printk("SPI error: %d\n", err);
	}
	else
	{
		/* Connect MISO to MOSI for loopback */
		printk("TX sent: %x\n", tx_buffer[0]);
		printk("RX recv: %x\n", rx_buffer[0]);
		tx_buffer[0]++;
	}
}

void main(void)
{
	printk("SPIM Example\n");
	spi_init();

	while (1)
	{
		spi_test_send();
		k_sleep(K_MSEC(1000));
	}
}
```
