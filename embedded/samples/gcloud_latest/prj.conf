## Kconfig
```
#
# Copyright (c) 2020 Nordic Semiconductor ASA
#
# SPDX-License-Identifier: LicenseRef-BSD-5-Clause-Nordic
#

menu "MQTT simple sample"
config MQTT_PUB_TOPIC
	string "MQTT publish topic"
	default "my/publish/topic"

config MQTT_SUB_TOPIC
	string "MQTT subscribe topic"
	default "my/subscribe/topic"

config MQTT_CLIENT_ID
	string "MQTT Client ID"
	default "my-client-id"

config MQTT_BROKER_HOSTNAME
	string "MQTT broker hostname"
	default "mqtt.eclipse.org"

config MQTT_BROKER_PORT
	int "MQTT broker port"
	default 1883

config MQTT_MESSAGE_BUFFER_SIZE
	int "MQTT message buffer size"
	default 128

config MQTT_PAYLOAD_BUFFER_SIZE
	int "MQTT payload buffer size"
	default 128

config BUTTON_EVENT_PUBLISH_MSG
	string "The message to publish on a button event"
	default "Hello from nRF91 MQTT Simple Sample"

config BUTTON_EVENT_BTN_NUM
	int "The button number"
	default 1

config MQTT_RECONNECT_DELAY_S
	int "Seconds to delay before attempting to reconnect to the broker."
	default 60

config LTE_CONNECT_RETRY_DELAY_S
	int "Seconds to delay before attempting to retry LTE connection."
	default 120

config MQTT_TLS_SEC_TAG
	int "TLS credentials security tag"
	default 24

config MQTT_TLS_SESSION_CACHING
	bool "Enable TLS session caching"

config MQTT_TLS_PEER_VERIFY
	int "Set peer verification level"
	default 2
	help
		Set to 0 for VERIFY_NONE, 1 for VERIFY_OPTIONAL, and 2 for
		VERIFY_REQUIRED.

endmenu

menu "Google Cloud"

config GCLOUD_PROJECT_NAME
    string "Name of the Google Cloud project"

config GCLOUD_REGION
    string "Google cloud region"

config GCLOUD_REGISTRY_NAME
    string "Name of the Google Cloud reigstry of the device"

config GCLOUD_DEVICE_NAME
    string "Name of the device in Google Cloud"

endmenu

menu "Zephyr Kernel"
source "Kconfig.zephyr"
endmenu

module = MQTT_SIMPLE
module-str = MQTT Simple
source "${ZEPHYR_BASE}/subsys/logging/Kconfig.template.log_config"
```

## prj.conf
```kconfig
#
# Copyright (c) 2020 Nordic Semiconductor ASA
#
# SPDX-License-Identifier: LicenseRef-BSD-5-Clause-Nordic
#

# Networking
CONFIG_NETWORKING=y
CONFIG_NET_NATIVE=n
CONFIG_NET_SOCKETS_OFFLOAD=y
CONFIG_NET_SOCKETS=y
CONFIG_NET_SOCKETS_POSIX_NAMES=y

# LTE link control
CONFIG_LTE_LINK_CONTROL=y
CONFIG_LTE_AUTO_INIT_AND_CONNECT=n

# BSD library
CONFIG_BSD_LIBRARY=y

# AT Host
CONFIG_UART_INTERRUPT_DRIVEN=y
CONFIG_AT_HOST_LIBRARY=y

# MQTT
CONFIG_MQTT_LIB=y
CONFIG_MQTT_LIB_TLS=n
CONFIG_MQTT_CLEAN_SESSION=y

CONFIG_MQTT_MESSAGE_BUFFER_SIZE=1024
CONFIG_MQTT_PAYLOAD_BUFFER_SIZE=1024

# MQTT TLS
CONFIG_MQTT_LIB_TLS=y
CONFIG_MQTT_BROKER_PORT=8883

# Modem key management, for provisioning certificates
CONFIG_MODEM_KEY_MGMT=y


# Application
# CONFIG_MQTT_PUB_TOPIC="my/publish/topic"
# CONFIG_MQTT_SUB_TOPIC="my/subscribe/topic"
# CONFIG_MQTT_CLIENT_ID="my-client-id"
# CONFIG_MQTT_BROKER_HOSTNAME="mqtt.eclipse.org"
# CONFIG_MQTT_BROKER_PORT=1883

# JWT
CONFIG_JWT=y
CONFIG_JWT_SIGN_ECDSA=y

# Google Cloud
CONFIG_GCLOUD_PROJECT_NAME="nordicoasys"
CONFIG_GCLOUD_REGION="europe-west1"
CONFIG_GCLOUD_REGISTRY_NAME="OasysFleet"
CONFIG_GCLOUD_DEVICE_NAME="nrf9160dk"

# Button support
CONFIG_DK_LIBRARY=y

# Enable logging
CONFIG_LOG=y
CONFIG_MQTT_SIMPLE_LOG_LEVEL_DBG=y

# Memory
CONFIG_MAIN_STACK_SIZE=4096
CONFIG_HEAP_MEM_POOL_SIZE=2048

CONFIG_NEWLIB_LIBC=y
```

## src/main.c
```c
/*
 * Copyright (c) 2018 Nordic Semiconductor ASA
 *
 * SPDX-License-Identifier: LicenseRef-BSD-5-Clause-Nordic
 */

#include <zephyr.h>
#include <stdio.h>
#include <drivers/uart.h>
#include <string.h>
#include <random/rand32.h>

#include <net/mqtt.h>
#include <net/socket.h>

#include <data/jwt.h>

#include <modem/lte_lc.h>
#include <logging/log.h>
#if defined(CONFIG_MODEM_KEY_MGMT)
#include <modem/modem_key_mgmt.h>
#endif
#if defined(CONFIG_LWM2M_CARRIER)
#include <lwm2m_carrier.h>
#endif
#include <dk_buttons_and_leds.h>

#include "cJSON.h"
#include "ntp.h"

LOG_MODULE_REGISTER(mqtt_simple, CONFIG_MQTT_SIMPLE_LOG_LEVEL);

/* Buffers for MQTT client. */
static uint8_t rx_buffer[CONFIG_MQTT_MESSAGE_BUFFER_SIZE];
static uint8_t tx_buffer[CONFIG_MQTT_MESSAGE_BUFFER_SIZE];
static uint8_t payload_buf[CONFIG_MQTT_PAYLOAD_BUFFER_SIZE];

/* The mqtt client struct */
static struct mqtt_client client;

/* MQTT Broker details. */
static struct sockaddr_storage broker;

/* File descriptor */
static struct pollfd fds;


/* GCLOUD FUNCTIONS */

#define ROOT_CERT \
    "-----BEGIN CERTIFICATE-----\n" \
    "MIIBdTCCARugAwIBAgIJAOvj4PVfAgqjMAoGCCqGSM49BAMCMBYxFDASBgNVBAMM\n" \
    "C25yZjkxLW1hcnRlMCAXDTE5MDQwNTExMTUxN1oYDzQ3NTcwMzAyMTExNTE3WjAW\n" \
    "MRQwEgYDVQQDDAtucmY5MS1tYXJ0ZTBZMBMGByqGSM49AgEGCCqGSM49AwEHA0IA\n" \
    "BAq8otkWGnocpdAxlnpJdVn6EBb1WbQnZXLFaYzsMeXWGFIIO02hWTvaSUPI1xNs\n" \
    "0QB8c3IU9oBhDXkRNU2Nqi2jUDBOMB0GA1UdDgQWBBRLAhO335CAd280I/qVQmiM\n" \
    "07nd8TAfBgNVHSMEGDAWgBRLAhO335CAd280I/qVQmiM07nd8TAMBgNVHRMEBTAD\n" \
    "AQH/MAoGCCqGSM49BAMCA0gAMEUCIF2kQO7Cqn73ANmwBdgGA1y/KGOpOU4I/ywF\n" \
    "LEu8trOUAiEA8//UWttMRkmaylghw3mgsYGGKk17rY+4j+4mGUwvDnw=\n" \
    "-----END CERTIFICATE-----"

#define GCLOUD_CA_CERTIFICATE ROOT_CERT
#define GCLOUD_SEC_TAG 16842752
#define SUBSCRIBE_ID 42

#define GCLOUD_ID "projects/" CONFIG_GCLOUD_PROJECT_NAME "/locations/" CONFIG_GCLOUD_REGION "/registries/" CONFIG_GCLOUD_REGISTRY_NAME "/devices/" CONFIG_GCLOUD_DEVICE_NAME
#define GCLOUD_HOSTNAME "mqtt.googleapis.com" 
#define BROKER_ADDR GCLOUD_HOSTNAME

#define GCLOUD_CONFIG_TOPIC "/devices/" CONFIG_GCLOUD_DEVICE_NAME "/config"
#define GCLOUD_STATE_TOPIC "/devices/" CONFIG_GCLOUD_DEVICE_NAME "/state"
#define GCLOUD_TOPIC "/devices/" CONFIG_GCLOUD_DEVICE_NAME "/events"

#define JWT_BUFFER_SIZE 256

/* Private key information */
extern unsigned char zepfull_private_der[];
extern unsigned int zepfull_private_der_len;

static struct mqtt_utf8 username = {
    .utf8 = "unused",
    .size = sizeof("unused")
};
char jwt_buffer[JWT_BUFFER_SIZE];
char jwt_buffer2[JWT_BUFFER_SIZE] = "hitest";
static struct mqtt_utf8 jwt_token = {.utf8 = jwt_buffer};
static struct mqtt_utf8 jwt_tokentest = {.utf8 = jwt_buffer2};

static struct mqtt_topic gcloud_topics_list[] = {
    {
        .topic = {
            .utf8 = GCLOUD_CONFIG_TOPIC,
            .size = sizeof(GCLOUD_CONFIG_TOPIC) - 1
        },
        .qos = MQTT_QOS_1_AT_LEAST_ONCE
    }
};

static int gcloud_provision(void)
{
	int err = 0;

	LOG_INF("Provisioning google cloud certificates");

	// nrf_sec_tag_t sec_tag = GCLOUD_SEC_TAG;

    // for(enum modem_key_mgmt_cred_type type = 0; type < 5; type++) {
    //     err = modem_key_mgmt_delete(sec_tag, type);
    //     if (err) {
    //         LOG_ERR("key delete err: [%d] %s", err, strerror(err));
    //     }
    // }

	err = modem_key_mgmt_write(GCLOUD_SEC_TAG,
				   MODEM_KEY_MGMT_CRED_TYPE_CA_CHAIN,
				   GCLOUD_CA_CERTIFICATE,
				   strlen(GCLOUD_CA_CERTIFICATE));
	if (err) {
		LOG_ERR("Failed to provision CA certificate: %d", err);
	}
	return err;
}

static int make_jwt(char *buffer, size_t buffer_size)
{
    int err;
    struct jwt_builder jb;

    err = jwt_init_builder(&jb, buffer, buffer_size);
    if (err != 0)
    {
        LOG_ERR("Unable to init JWT builder: %d", err);
        return err;
    }

    uint32_t timestamp = ntp_get_unix_time();
    if (timestamp < 0)
    {
        LOG_ERR("Unable to get Unix time: %d", err);
        return err;
    }

    err = jwt_add_payload(&jb, timestamp + 12 * 60 * 60, timestamp,
                          CONFIG_GCLOUD_PROJECT_NAME);
    if (err != 0)
    {
        LOG_ERR("Unable to add JWT payload: %d", err);
        return err;
    }

    err = jwt_sign(&jb, zepfull_private_der, zepfull_private_der_len);
    if (err != 0)
    {
        LOG_ERR("Unable to sign JWT token: %d", err);
        return err;
    }

    if (jb.overflowed != 0)
    {
        LOG_ERR("JWT buffer overflowed");
        return -ENOMEM;
    }
    return err;
}







#if defined(CONFIG_BSD_LIBRARY)

/**@brief Recoverable BSD library error. */
void bsd_recoverable_error_handler(uint32_t err)
{
	LOG_ERR("bsdlib recoverable error: %u", (unsigned int)err);
}

#endif /* defined(CONFIG_BSD_LIBRARY) */

/**@brief Function to print strings without null-termination
 */
static void data_print(uint8_t *prefix, uint8_t *data, size_t len)
{
	char buf[len + 1];

	memcpy(buf, data, len);
	buf[len] = 0;
	LOG_INF("%s%s", log_strdup(prefix), log_strdup(buf));
}

/**@brief Function to publish data on the configured topic
 */
static int data_publish(struct mqtt_client *c, enum mqtt_qos qos,
	uint8_t *data, size_t len)
{
	struct mqtt_publish_param param;

	param.message.topic.qos = qos;
	param.message.topic.topic.utf8 = GCLOUD_TOPIC;
	param.message.topic.topic.size = strlen(GCLOUD_TOPIC);
	param.message.payload.data = data;
	param.message.payload.len = len;
	param.message_id = sys_rand32_get();
	param.dup_flag = 0;
	param.retain_flag = 0;

	data_print("Publishing: ", data, len);
	LOG_INF("to topic: %s len: %u",
		GCLOUD_TOPIC,
		(unsigned int)strlen(GCLOUD_TOPIC));

	return mqtt_publish(c, &param);
}

/**@brief Function to subscribe to the configured topic
 */
static int subscribe(void)
{
	const struct mqtt_subscription_list subscription_list = {
		.list = (struct mqtt_topic *)&gcloud_topics_list,
		.list_count = ARRAY_SIZE(gcloud_topics_list),
		.message_id = SUBSCRIBE_ID
	};

	return mqtt_subscribe(&client, &subscription_list);
}

/**@brief Function to read the published payload.
 */
static int publish_get_payload(struct mqtt_client *c, size_t length)
{
	if (length > sizeof(payload_buf)) {
		return -EMSGSIZE;
	}

	return mqtt_readall_publish_payload(c, payload_buf, length);
}

/**@brief MQTT client event handler
 */
void mqtt_evt_handler(struct mqtt_client *const c,
		      const struct mqtt_evt *evt)
{
	int err;

	switch (evt->type) {
	case MQTT_EVT_CONNACK:
		if (evt->result != 0) {
			LOG_ERR("MQTT connect failed: %d", evt->result);
			break;
		}

		LOG_INF("MQTT client connected");
		subscribe();
		break;

	case MQTT_EVT_DISCONNECT:
		LOG_INF("MQTT client disconnected: %d", evt->result);
		break;

	case MQTT_EVT_PUBLISH: {
		const struct mqtt_publish_param *p = &evt->param.publish;

		LOG_INF("MQTT PUBLISH result=%d len=%d",
			evt->result, p->message.payload.len);
		err = publish_get_payload(c, p->message.payload.len);

		if (p->message.topic.qos == MQTT_QOS_1_AT_LEAST_ONCE) {
			const struct mqtt_puback_param ack = {
				.message_id = p->message_id
			};

			/* Send acknowledgment. */
			mqtt_publish_qos1_ack(&client, &ack);
		}

		if (err >= 0) {
			data_print("Received: ", payload_buf,
				p->message.payload.len);
			/* Echo back received data */
			data_publish(&client, MQTT_QOS_1_AT_LEAST_ONCE,
				payload_buf, p->message.payload.len);
		} else {
			LOG_ERR("publish_get_payload failed: %d", err);
			LOG_INF("Disconnecting MQTT client...");

			err = mqtt_disconnect(c);
			if (err) {
				LOG_ERR("Could not disconnect: %d", err);
			}
		}
	} break;

	case MQTT_EVT_PUBACK:
		if (evt->result != 0) {
			LOG_ERR("MQTT PUBACK error: %d", evt->result);
			break;
		}

		LOG_INF("PUBACK packet id: %u", evt->param.puback.message_id);
		break;

	case MQTT_EVT_SUBACK:
		if (evt->result != 0) {
			LOG_ERR("MQTT SUBACK error: %d", evt->result);
			break;
		}

		LOG_INF("SUBACK packet id: %u", evt->param.suback.message_id);
		break;

	case MQTT_EVT_PINGRESP:
		if (evt->result != 0) {
			LOG_ERR("MQTT PINGRESP error: %d", evt->result);
		}
		break;

	default:
		LOG_INF("Unhandled MQTT event type: %d", evt->type);
		break;
	}
}

/**@brief Resolves the configured hostname and
 * initializes the MQTT broker structure
 */
static int broker_init(void)
{
	int err;
	struct addrinfo *result;
	struct addrinfo *addr;
	struct addrinfo hints = {
		.ai_family = AF_INET,
		.ai_socktype = SOCK_STREAM
	};

	err = getaddrinfo(GCLOUD_HOSTNAME, NULL, &hints, &result);
	if (err) {
		LOG_ERR("getaddrinfo failed: %d", err);
		return -ECHILD;
	}

	addr = result;

	/* Look for address of the broker. */
	while (addr != NULL) {
		/* IPv4 Address. */
		if (addr->ai_addrlen == sizeof(struct sockaddr_in)) {
			struct sockaddr_in *broker4 =
				((struct sockaddr_in *)&broker);
			char ipv4_addr[NET_IPV4_ADDR_LEN];

			broker4->sin_addr.s_addr =
				((struct sockaddr_in *)addr->ai_addr)
				->sin_addr.s_addr;
			broker4->sin_family = AF_INET;
			broker4->sin_port = htons(CONFIG_MQTT_BROKER_PORT);

			inet_ntop(AF_INET, &broker4->sin_addr.s_addr,
				  ipv4_addr, sizeof(ipv4_addr));
			LOG_INF("IPv4 Address found %s", log_strdup(ipv4_addr));

			break;
		} else {
			LOG_ERR("ai_addrlen = %u should be %u or %u",
				(unsigned int)addr->ai_addrlen,
				(unsigned int)sizeof(struct sockaddr_in),
				(unsigned int)sizeof(struct sockaddr_in6));
		}

		addr = addr->ai_next;
	}

	/* Free the address. */
	freeaddrinfo(result);

	return err;
}

/**@brief Initialize the MQTT client structure
 */
static int client_init(struct mqtt_client *client)
{
	int err;

	mqtt_client_init(client);

	err = make_jwt(jwt_buffer, JWT_BUFFER_SIZE);
    if (err != 0) {
        LOG_ERR("Unable to make jwt: %d", err);
        return err;
    }
	
	LOG_DBG("\nJWT length: %d\n", strlen(jwt_buffer));

    jwt_token.size = strlen(jwt_buffer);
	jwt_tokentest.size = strlen(jwt_buffer2);


	err = broker_init();
	if (err) {
		LOG_ERR("Failed to initialize broker connection");
		return err;
	}

	//COMEBACK

	/* MQTT client configuration */
	client->broker = &broker;
	client->evt_cb = mqtt_evt_handler;
	client->client_id.utf8 = GCLOUD_ID;
	client->client_id.size = strlen(GCLOUD_ID);
	client->password = &jwt_token;
	client->user_name = &username;
	client->protocol_version = MQTT_VERSION_3_1_1;

	/* MQTT buffers configuration */
	client->rx_buf = rx_buffer;
	client->rx_buf_size = sizeof(rx_buffer);
	client->tx_buf = tx_buffer;
	client->tx_buf_size = sizeof(tx_buffer);

	/* MQTT transport configuration */
#if defined(CONFIG_MQTT_LIB_TLS)
	struct mqtt_sec_config *tls_cfg = &(client->transport).tls.config;
	static sec_tag_t sec_tag_list[] = { GCLOUD_SEC_TAG };

	LOG_INF("TLS enabled");
	client->transport.type = MQTT_TRANSPORT_SECURE;

	tls_cfg->peer_verify = 0;
	tls_cfg->cipher_count = 0;
	tls_cfg->cipher_list = NULL;
	tls_cfg->sec_tag_count = ARRAY_SIZE(sec_tag_list);
	tls_cfg->sec_tag_list = sec_tag_list;
	tls_cfg->hostname = GCLOUD_HOSTNAME;

#if defined(CONFIG_BSD_LIBRARY)
	tls_cfg->session_cache = IS_ENABLED(CONFIG_MQTT_TLS_SESSION_CACHING) ?
					    TLS_SESSION_CACHE_ENABLED :
					    TLS_SESSION_CACHE_DISABLED;
#else
	/* TLS session caching is not supported by the Zephyr network stack */
	tls_cfg->session_cache = TLS_SESSION_CACHE_DISABLED;

#endif

#else
	client->transport.type = MQTT_TRANSPORT_NON_SECURE;
#endif

	return err;
}

/**@brief Initialize the file descriptor structure used by poll.
 */
static int fds_init(struct mqtt_client *c)
{
	if (c->transport.type == MQTT_TRANSPORT_NON_SECURE) {
		fds.fd = c->transport.tcp.sock;
	} else {
#if defined(CONFIG_MQTT_LIB_TLS)
		fds.fd = c->transport.tls.sock;
#else
		return -ENOTSUP;
#endif
	}

	fds.events = POLLIN;

	return 0;
}

static void button_handler(uint32_t button_states, uint32_t has_changed)
{
	if (has_changed & button_states &
	    BIT(CONFIG_BUTTON_EVENT_BTN_NUM - 1)) {
		int ret;

		ret = data_publish(&client,
				   MQTT_QOS_1_AT_LEAST_ONCE,
				   CONFIG_BUTTON_EVENT_PUBLISH_MSG,
				   sizeof(CONFIG_BUTTON_EVENT_PUBLISH_MSG)-1);
		if (ret) {
			LOG_ERR("Publish failed: %d", ret);
		}
	}
}

/**@brief Configures modem to provide LTE link. Blocks until link is
 * successfully established.
 */
static int modem_configure(void)
{
#if defined(CONFIG_LTE_LINK_CONTROL)
	if (IS_ENABLED(CONFIG_LTE_AUTO_INIT_AND_CONNECT)) {
		/* Do nothing, modem is already turned on
		 * and connected.
		 */
	} else {
#if defined(CONFIG_LWM2M_CARRIER)
		/* Wait for the LWM2M_CARRIER to configure the modem and
		 * start the connection.
		 */
		LOG_INF("Waitng for carrier registration...");
		k_sem_take(&carrier_registered, K_FOREVER);
		LOG_INF("Registered!");
#else /* defined(CONFIG_LWM2M_CARRIER) */
		int err;

		LOG_INF("LTE Link Connecting...");
		err = lte_lc_init_and_connect();
		if (err) {
			LOG_INF("Failed to establish LTE connection: %d", err);
			return err;
		}
		LOG_INF("LTE Link Connected!");
#endif /* defined(CONFIG_LWM2M_CARRIER) */
	}
#endif /* defined(CONFIG_LTE_LINK_CONTROL) */

	/* Turn off power saving modes for a more responsive demo */
	LOG_INF("Disabling PSM and eDRX");
	lte_lc_psm_req(false);
	lte_lc_edrx_req(false);

	return 0;
}

void main(void)
{
	int err;
	uint32_t connect_attempt = 0;

	LOG_INF("The MQTT simple sample started");

#if defined(CONFIG_MQTT_LIB_TLS)
	err = gcloud_provision();
	if (err != 0) {
		LOG_ERR("Failed to provision google cloud certificates");
		return;
	}
#endif /* defined(CONFIG_MQTT_LIB_TLS) */

	do {
		err = modem_configure();
		if (err) {
			LOG_INF("Retrying in %d seconds",
				CONFIG_LTE_CONNECT_RETRY_DELAY_S);
			k_sleep(K_SECONDS(CONFIG_LTE_CONNECT_RETRY_DELAY_S));
		}
	} while (err);

	

	err = client_init(&client);
	if (err != 0) {
		LOG_ERR("client_init: %d", err);
		return;
	}

	 dk_buttons_init(button_handler);

do_connect:
	if (connect_attempt++ > 0) {
		LOG_INF("Reconnecting in %d seconds...",
			CONFIG_MQTT_RECONNECT_DELAY_S);
		k_sleep(K_SECONDS(CONFIG_MQTT_RECONNECT_DELAY_S));
	}
	err = mqtt_connect(&client);
	if (err != 0) {
		LOG_ERR("mqtt_connect %d", err);
		goto do_connect;
	}

	err = fds_init(&client);
	if (err != 0) {
		LOG_ERR("fds_init: %d", err);
		return;
	}

	uint32_t cnt = 0;
	while (1) {
		err = poll(&fds, 1, mqtt_keepalive_time_left(&client));
		if (err < 0) {
			LOG_ERR("poll: %d", errno);
			break;
		}

		err = mqtt_live(&client);
		if ((err != 0) && (err != -EAGAIN)) {
			LOG_ERR("ERROR: mqtt_live: %d", err);
			break;
		}

		if ((fds.revents & POLLIN) == POLLIN) {
			err = mqtt_input(&client);
			if (err != 0) {
				LOG_ERR("mqtt_input: %d", err);
				break;
			}
		}

		if ((fds.revents & POLLERR) == POLLERR) {
			LOG_ERR("POLLERR");
			break;
		}

		if ((fds.revents & POLLNVAL) == POLLNVAL) {
			LOG_ERR("POLLNVAL");
			break;
		}

        double yrNum = 22021 - cnt;
        cJSON * yrObj = cJSON_CreateObject();
        cJSON * year = NULL;
        char * JSONString = NULL;
        year = cJSON_CreateNumber(yrNum);
        const char * yrStr = "Message";

        cJSON_AddItemToObject(yrObj, yrStr, year);
        JSONString = cJSON_Print(yrObj);
        cJSON_Delete(yrObj);

	    printk("Sending JSON data:\n%s\n", JSONString);
	    data_publish(&client, MQTT_QOS_1_AT_LEAST_ONCE, JSONString, strlen(JSONString));
		cnt++;

	}

	LOG_INF("Disconnecting MQTT client...");

	err = mqtt_disconnect(&client);
	if (err) {
		LOG_ERR("Could not disconnect MQTT client: %d", err);
	}
	goto do_connect;
}
```

## include/ntp.h
```c
/*
 * Copyright (c) 2018 Nordic Semiconductor ASA
 *
 * SPDX-License-Identifier: LicenseRef-BSD-5-Clause-Nordic
 */

#ifndef _NTP_H_
#define _NTP_H_

#include <zephyr.h>
#include <net/socket.h>
#include <stdio.h>
#include <drivers/uart.h>
#include <string.h>
#include <time.h>
#include "ntp.h"

struct ntp_format
{
	uint8_t flags;
	uint8_t stratum;		/* stratum */
	uint8_t poll;			/* poll interval */
	uint8_t precision;		/* precision */
	uint32_t rootdelay;	/* root delay */
	uint32_t rootdisp;		/* root dispersion */
	uint32_t refid;		/* reference ID */
	uint32_t reftime_sec;  /* reference time */
	uint32_t reftime_frac; /* reference time */
	uint32_t org_sec;		/* origin timestamp */
	uint32_t org_frac;		/* origin timestamp */
	uint32_t rec_sec;		/* receive timestamp */
	uint32_t rec_frac;		/* receive timestamp */
	uint32_t xmt_sec;		/* transmit timestamp */
	uint32_t xmt_frac;		/* transmit timestamp */
};

/**
 * @brief Receive data from a connected peer while blocking.
 * 
 * @note The recv() function is equivalent to recvfrom() with null pointer
 *       src_addr and addrlen arguments, and to read() if the socket
 *       argument refers to a socket and the flags argument is 0.
 * @note The select() and poll() functions can be used to determine when data
 *       is available to be received.
 * @note For a description of the flags parameter, see the full normative
 * 		 description at `POSIX.1-2017 article
 * 		 <http://pubs.opengroup.org/onlinepubs/9699919799/functions/recv.html>`
 * 
 * @param[in] fd Specifies the socket file descriptor.
 * @param[in] buf Points to a buffer where the message should be stored.
 * @param[in] size Specifies the length in bytes of the buffer pointed to by
 *            the buffer argument.
 * @param[in] flags Specifies the type of message reception.
 * 
 * @retval Upon successful completion, recv() shall return the length of the
 *         message in bytes. If no messages are available to be received and
 *         the peer has performed an orderly shutdown, recv() shall return 0.
 *         Otherwise, -1 shall be returned and errno set to indicate the error.
 */
int blocking_recv(int fd, uint8_t *buf, uint32_t size, uint32_t flags);

/**
 * @brief Receive data from an arbitrary network address while blocking.
 * 
 * @note The select() and poll() functions can be used to determine when data
 *       is available to be received.
 * @note For a description of the flags parameter, see the full normative
 * 		 description at `POSIX.1-2017 article
 * 		 <http://pubs.opengroup.org/onlinepubs/9699919799/functions/recvfrom.html>`
 * 
 * @param[in] fd Specifies the socket file descriptor.
 * @param[in] buf Points to the buffer where the message should be stored.
 * @param[in] size Specifies the length in bytes of the buffer pointed to by
 *            the buffer argument.
 * @param[in] flags Specifies the type of message reception.
 * @param[in] src_addr A null pointer, or points to a sockaddr structure in
 *            which the sending address is to be stored. The length and format
 *            of the address depend on the address family of the socket.
 * @param[in] addrlen Either a null pointer, if address is a null pointer, or a
 *            pointer to a socklen_t object which on input specifies the length
 *            of the supplied sockaddr structure, and on output specifies the
 *            length of the stored address.
 * 
 * @retval Upon successful completion, recvfrom() shall return the length of
 *         the message in bytes. If no messages are available to be received
 *         and the peer has performed an orderly shutdown, recvfrom() shall
 *         return 0. Otherwise, the function shall return -1 and set errno to
 *         indicate the error.
 */
int blocking_recvfrom(int fd, void *buf, uint32_t size, uint32_t flags,
					  struct sockaddr *src_addr, socklen_t *addrlen);

/**
 * @brief Send data to a connected peer while blocking.
 * 
 * @note If the socket argument refers to a connection-mode socket, the send()
 *       function is equivalent to sendto() (with any value for the dest_addr
 *       and dest_len arguments, as they are ignored in this case). If the
 *       socket argument refers to a socket and the flags argument is 0, the
 *       send() function is equivalent to write().
 * @note For a description of the flags parameter, see the full normative
 * 		 description at `POSIX.1-2017 article
 * 		 <http://pubs.opengroup.org/onlinepubs/9699919799/functions/send.html>`
 * 
 * @param[in] fd Specifies the socket file descriptor.
 * @param[in] buf Points to the buffer containing the message to send.
 * @param[in] size Specifies the length of the message in bytes.
 * @param[in] flags Specifies the type of message transmission.
 * 
 * @retval Upon successful completion, send() shall return the number of bytes
 *         sent. Otherwise, -1 shall be returned and errno set to indicate the
 *         error.
 */
int blocking_send(int fd, uint8_t *buf, uint32_t size, uint32_t flags);

/**
 * @brief Connect a socket to a peer network address while blocking.
 * 
 * @note If connect() fails, the state of the socket is unspecified. Conforming
 *       applications should close the file descriptor and create a new socket
 *       before attempting to reconnect.
 * @note For a description of the flags parameter, see the full normative
 * 		 description at `POSIX.1-2017 article
 * 		 <http://pubs.opengroup.org/onlinepubs/9699919799/functions/connect.html>`
 * 
 * @param[in] fd Specifies the file descriptor associated with the socket.
 * @param[in] local_addr Points to a sockaddr structure containing the peer
 *            address. The length and format of the address depend on the
 *            address family of the socket.
 * @param[in] len Specifies the length of the sockaddr structure pointed to by
 *            the address argument.
 * 
 * @retval Upon successful completion, connect() shall return 0; otherwise, -1
 *         shall be returned and errno set to indicate the error.
 */
int blocking_connect(int fd, struct sockaddr *local_addr, socklen_t len);

/**
 * @brief Convert NTP time values from host to network byte order.
 * 
 * @param[in] ntp Points to the ntp_format object to be converted.
 */
void ntp_swap_endianess(struct ntp_format *ntp);

/**
 * @brief Get Unix time from NTP server.
 * 
 * @note Only supports IPv4.
 * 
 * @retval Upon successful completion, returns Unix timestamp at the time that
 *         the server replied, in seconds. Otherwise, returns a negative error
 *         code indicating reason for failure.
 */
uint32_t ntp_get_unix_time(void);

#endif /* _NTP_H_ */
```
