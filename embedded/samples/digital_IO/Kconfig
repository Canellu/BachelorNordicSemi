## embedded/samples/digital_IO/Kconfig
```kconfig
#
# Copyright (c) 2020 Nordic Semiconductor ASA
#
# SPDX-License-Identifier: LicenseRef-BSD-5-Clause-Nordic
#

menu "additional config"

config BUTTON_EVENT_BTN_NUM
	int "The button number"
	default 1

endmenu

menu "Zephyr Kernel"
source "Kconfig.zephyr"
endmenu

module = MQTT_SIMPLE
module-str = MQTT Simple
source "${ZEPHYR_BASE}/subsys/logging/Kconfig.template.log_config"
```

## embedded/samples/lpuart/build/Kconfig/Kconfig.soc.arch
```kconfig
osource "C:/Users/Einar/ncs/v1.4.99-dev1/zephyr/soc/$(ARCH)/Kconfig"
osource "C:/Users/Einar/ncs/v1.4.99-dev1/zephyr/soc/$(ARCH)/*/Kconfig"
```

## embedded/samples/mqtt_simple/build/spm/Kconfig/Kconfig.soc.arch
```kconfig
osource "C:/Users/Einar/ncs/v1.4.1/zephyr/soc/$(ARCH)/Kconfig"
osource "C:/Users/Einar/ncs/v1.4.1/zephyr/soc/$(ARCH)/*/Kconfig"
```

## embedded/samples/nrfgcloud_new/build/spm/Kconfig/Kconfig.shield
```kconfig
osource "C:/Users/Einar/ncs/v1.4.99-dev1/nrf/boards/shields/*/Kconfig.shield"
osource "C:/Users/Einar/ncs/v1.4.99-dev1/zephyr/boards/shields/*/Kconfig.shield"
```

## embedded/samples/nrfgcloud_new/build/spm/Kconfig/Kconfig.shield.defconfig
```kconfig
osource "C:/Users/Einar/ncs/v1.4.99-dev1/nrf/boards/shields/*/Kconfig.defconfig"
osource "C:/Users/Einar/ncs/v1.4.99-dev1/zephyr/boards/shields/*/Kconfig.defconfig"
```
