## Kconfig
```
config GCLOUD_PROJECT_NAME
    string "Name of the Google Cloud project"

config GCLOUD_REGION
    string "Google cloud region"

config GCLOUD_REGISTRY_NAME
    string "Name of the Google Cloud reigstry of the device"

config GCLOUD_DEVICE_NAME
    string "Name of the device in Google Cloud"
    
# Include Zephyr's Kconfig
menu "Zephyr Kernel"
source "Kconfig.zephyr"
endmenu
```

## prj.conf
```kconfig
CONFIG_NEWLIB_LIBC=y
CONFIG_NEWLIB_LIBC_FLOAT_PRINTF=y
CONFIG_SERIAL=y
CONFIG_TEST_RANDOM_GENERATOR=y
CONFIG_NETWORKING=y
CONFIG_NET_SOCKETS_OFFLOAD=y
CONFIG_NET_SOCKETS=y
CONFIG_NET_SOCKETS_POSIX_NAMES=y
CONFIG_NET_RAW_MODE=y

# LTE link control
CONFIG_LTE_LINK_CONTROL=y
CONFIG_LTE_AUTO_INIT_AND_CONNECT=n

# AT host
CONFIG_AT_HOST_LIBRARY=y

# BSD library, this selects NET_RAW_MODE
CONFIG_BSD_LIBRARY=y

# Disable Modem traces, since we need UART1 for HCI
CONFIG_BSD_LIBRARY_TRACE_ENABLED=n

# Library for buttons and LEDs
CONFIG_DK_LIBRARY=y
CONFIG_DK_LIBRARY_INVERT_LEDS=n

# MQTT
CONFIG_MQTT_SOCKET_LIB=y
CONFIG_MQTT_LIB_TLS=y
CONFIG_MQTT_MAX_PACKET_LENGTH=2048

# Console
CONFIG_CONSOLE_SUBSYS=y
CONFIG_CONSOLE_HANDLER=y
CONFIG_CONSOLE_GETCHAR=y

CONFIG_CONSOLE=y
CONFIG_STDOUT_CONSOLE=y
CONFIG_UART_CONSOLE=y

# Main thread
CONFIG_MAIN_THREAD_PRIORITY=7

CONFIG_UART_INTERRUPT_DRIVEN=y

CONFIG_FP_SHARING=y

CONFIG_LOG_STRDUP_MAX_STRING=128
CONFIG_LOG_STRDUP_BUF_COUNT=6
CONFIG_LOG_PRINTK=y

# Heap and stacks
CONFIG_HEAP_MEM_POOL_SIZE=2048
CONFIG_MAIN_STACK_SIZE=4096

# Logging
CONFIG_LOG=y
CONFIG_LOG_BACKEND_SHOW_COLOR=n
CONFIG_LOG_DEFAULT_LEVEL=4

# JWT
CONFIG_JWT=y
CONFIG_JWT_SIGN_ECDSA=y

# Google Cloud
CONFIG_GCLOUD_REGION="us-central1"
CONFIG_GCLOUD_PROJECT_NAME="PROJECT_NAME"
CONFIG_GCLOUD_REGISTRY_NAME="REGISTRY_NAME"
CONFIG_GCLOUD_DEVICE_NAME="DEVICE_NAME"
```

## src/main.c
```c
#include <zephyr.h>
#include <device.h>
#include <modem/lte_lc.h>
#include <net/mqtt.h>
#include <string.h>
#include <errno.h>
#include <bsd.h>
#include <nrf_socket.h>
#include <net/socket.h>
#include <stdio.h>
#include <stdlib.h>
#include <dk_buttons_and_leds.h>

#include <ntp.h>
#include <gcloud.h>
#include <cJSON.h>

#define SLEEP_TIME 10010
#define READ_INTERVAL  2000

// Forward declarations

void store_modem_configuration(void);

// Handlers

void button_handler(u32_t button_state, u32_t has_chandged)
{
    printk("Button event: %x    %x\n", button_state, has_chandged);
    if ( (has_chandged & 0x01) && (button_state & 0x01) ) {
        store_modem_configuration();
    }
}

/**@brief Handler for when receiving GPS data from Google Cloud.
 * Should also do something with the data when we know what to do.
 */ 

void received_config_handler(const struct mqtt_publish_message *message) {

	cJSON * data_json = cJSON_Parse(message->payload.data);

    printk("%s\n",cJSON_Print(data_json));

	cJSON_Delete(data_json);

}


// Initializers

/**@brief Configures modem to provide LTE link. Blocks until link is
 * successfully established.
 */
static void modem_configure(void)
{
    if (IS_ENABLED(CONFIG_LTE_AUTO_INIT_AND_CONNECT)) {
        /* Do nothing, modem is already turned on and connected. */
    } else {
        int err;

        printk("Establishing LTE link (this may take some time) ...\n");
        err = lte_lc_init_and_connect();
        __ASSERT(err == 0, "LTE link could not be established.");
    }
}

/**@brief Configure LEDs and buttons. */
static void init_leds_and_buttons(void)
{
    int err;

    err = dk_leds_init();
    if (err) {
        printk("Could not initialize leds, err code: %d\n", err);
    }

    err = dk_buttons_init(button_handler);
    if (err) {
        printk("Could not initialize buttons, err code: %d\n", err);
    }

    err = dk_set_leds_state(0x00, DK_ALL_LEDS_MSK);
    if (err) {
        printk("Could not set led state, err code: %d\n", err);
    }
}

// TODO: FIX OR IGNORE
void store_modem_configuration(void)
{
    int err;

    printk("Storing modem configuration...");
    err = lte_lc_power_off();
    if (err) {
        printk("Fail turning off modem: %d\n", err);
    }
    printk("Modem offline, turning back on...");
    dk_set_led_off(1);

    err = lte_lc_normal();
    if (err) {
        printk("Fail turning on modem: %d\n", err);
    }
    dk_set_led_on(1);
    printk("Done\n");
}

void main(void)
{
	int err;
	init_leds_and_buttons();
	dk_set_led_on(0); // The app has started
	printk("Provisioning\n");
	err = gcloud_provision();
	if (err) {
        printk("Failed to provision: %d\n", err);
        k_sleep(K_FOREVER);
    } else {
        printk("Provisioning complete\n");
    }
	printk("Initializing modem\n");
    modem_configure();
    dk_set_led_on(1); // The modem is configured
    printk("Modem configured\n");

	err = gcloud_connect(received_config_handler);
    if (err) {
        printk("Failed to connect to Google Cloud, error: %d\n", err);
        k_sleep(K_FOREVER);
    }
    printk("Connecting to Google Cloud\n");

	u32_t cnt = 0;
    for(int i = 0; ; i++) {
        cnt++ % 2 == 0 ? dk_set_led_on(3) : dk_set_led_off(3);
        k_sleep(K_MSEC(SLEEP_TIME));

        double yrNum = 22019 - cnt;
        cJSON * yrObj = cJSON_CreateObject();
        cJSON * year = NULL;
        char * JSONString = NULL;
        year = cJSON_CreateNumber(yrNum);
        const char * yrStr = "Message";

        cJSON_AddItemToObject(yrObj, yrStr, year);
        JSONString = cJSON_Print(yrObj);
        cJSON_Delete(yrObj);

	    printk("Sending JSON data:\n%s\n", JSONString);
	    gcloud_publish(JSONString, strlens(JSONString), MQTT_QOS_1_AT_LEAST_ONCE);
    }
	gcloud_disconnect();

}
```

## include/cJSON.h
```c
/*
  Copyright (c) 2009 Dave Gamble
 

  Permission is hereby granted, free of charge, to any person obtaining a copy
  of this software and associated documentation files (the "Software"), to deal
  in the Software without restriction, including without limitation the rights
  to use, copy, modify, merge, publish, distribute, sublicense, and/or sell
  copies of the Software, and to permit persons to whom the Software is
  furnished to do so, subject to the following conditions:
 

  The above copyright notice and this permission notice shall be included in
  all copies or substantial portions of the Software.
 

  THE SOFTWARE IS PROVIDED "AS IS", WITHOUT WARRANTY OF ANY KIND, EXPRESS OR
  IMPLIED, INCLUDING BUT NOT LIMITED TO THE WARRANTIES OF MERCHANTABILITY,
  FITNESS FOR A PARTICULAR PURPOSE AND NONINFRINGEMENT. IN NO EVENT SHALL THE
  AUTHORS OR COPYRIGHT HOLDERS BE LIABLE FOR ANY CLAIM, DAMAGES OR OTHER
  LIABILITY, WHETHER IN AN ACTION OF CONTRACT, TORT OR OTHERWISE, ARISING FROM,
  OUT OF OR IN CONNECTION WITH THE SOFTWARE OR THE USE OR OTHER DEALINGS IN
  THE SOFTWARE.
*/

#ifndef cJSON__h
#define cJSON__h

#ifdef __cplusplus
extern "C" {
#endif

#include <stddef.h>

/* cJSON Types: */
#define cJSON_False 0
#define cJSON_True 1
#define cJSON_NULL 2
#define cJSON_Number 3
#define cJSON_String 4
#define cJSON_Array 5
#define cJSON_Object 6

#define cJSON_IsReference 256
#define cJSON_StringIsConst 512

#define strlens(s) (s==NULL?0:strlen(s))

/* The cJSON structure: */
typedef struct cJSON {
	struct cJSON *next, *prev; /* next/prev allow you to walk array/object
				      chains. Alternatively, use
				      GetArraySize/GetArrayItem/GetObjectItem */
	struct cJSON *child;       /* An array or object item will have a child
				      pointer pointing to a chain of the items in the
				      array/object. */

	int type; /* The type of the item, as above. */

	char *valuestring;  /* The item's string, if type==cJSON_String */
	int valueint;       /* The item's number, if type==cJSON_Number */
	double valuedouble; /* The item's number, if type==cJSON_Number */

	char *string; /* The item's name string, if this item is the child of,
			 or is in the list of subitems of an object. */
} cJSON;

typedef struct cJSON_Hooks {
	void *(*malloc_fn)(size_t sz);
	void (*free_fn)(void *ptr);
} cJSON_Hooks;

/* Supply malloc, realloc and free functions to cJSON */
extern void cJSON_InitHooks(cJSON_Hooks *hooks);


/* Supply a block of JSON, and this returns a cJSON object you can interrogate.
 * Call cJSON_Delete when finished. */
extern cJSON *cJSON_Parse(const char *value);
/* Render a cJSON entity to text for transfer/storage. Free the char* when
 * finished. */
extern char *cJSON_Print(cJSON *item);
/* Render a cJSON entity to text for transfer/storage without any formatting.
 * Free the char* when finished. */
extern char *cJSON_PrintUnformatted(cJSON *item);
/* Render a cJSON entity to text using a buffered strategy. prebuffer is a guess
 * at the final size. guessing well reduces reallocation. fmt=0 gives
 * unformatted, =1 gives formatted */
extern char *cJSON_PrintBuffered(cJSON *item, int prebuffer, int fmt);
/* Delete a cJSON entity and all subentities. */
extern void cJSON_Delete(cJSON *c);

/* Returns the number of items in an array (or object). */
extern int cJSON_GetArraySize(cJSON *array);
/* Retrieve item number "item" from array "array". Returns NULL if unsuccessful.
 */
extern cJSON *cJSON_GetArrayItem(cJSON *array, int item);
/* Get item "string" from object. Case insensitive. */
extern cJSON *cJSON_GetObjectItem(cJSON *object, const char *string);

/* For analysing failed parses. This returns a pointer to the parse error.
 * You'll probably need to look a few chars back to make sense of it. Defined
 * when cJSON_Parse() returns 0. 0 when cJSON_Parse() succeeds. */
extern const char *cJSON_GetErrorPtr(void);

/* These calls create a cJSON item of the appropriate type. */
extern cJSON *cJSON_CreateNull(void);
extern cJSON *cJSON_CreateTrue(void);
extern cJSON *cJSON_CreateFalse(void);
extern cJSON *cJSON_CreateBool(int b);
extern cJSON *cJSON_CreateNumber(double num);
extern cJSON *cJSON_CreateString(const char *string);
extern cJSON *cJSON_CreateArray(void);
extern cJSON *cJSON_CreateObject(void);

/* These utilities create an Array of count items. */
extern cJSON *cJSON_CreateIntArray(const int *numbers, int count);
extern cJSON *cJSON_CreateFloatArray(const float *numbers, int count);
extern cJSON *cJSON_CreateDoubleArray(const double *numbers, int count);
extern cJSON *cJSON_CreateStringArray(const char **strings, int count);

/* Append item to the specified array/object. */
extern void cJSON_AddItemToArray(cJSON *array, cJSON *item);
extern void cJSON_AddItemToObject(cJSON *object, const char *string,
				  cJSON *item);
extern void cJSON_AddItemToObjectCS(
	cJSON *object, const char *string,
	cJSON *item); /* Use this when string is definitely const (i.e. a
			 literal, or as good as), and will definitely survive
			 the cJSON object */
/* Append reference to item to the specified array/object. Use this when you
 * want to add an existing cJSON to a new cJSON, but don't want to corrupt your
 * existing cJSON. */
extern void cJSON_AddItemReferenceToArray(cJSON *array, cJSON *item);
extern void cJSON_AddItemReferenceToObject(cJSON *object, const char *string,
					   cJSON *item);

/* Remove/Detatch items from Arrays/Objects. */
extern cJSON *cJSON_DetachItemFromArray(cJSON *array, int which);
extern void cJSON_DeleteItemFromArray(cJSON *array, int which);
extern cJSON *cJSON_DetachItemFromObject(cJSON *object, const char *string);
extern void cJSON_DeleteItemFromObject(cJSON *object, const char *string);

/* Update array items. */
extern void cJSON_InsertItemInArray(
	cJSON *array, int which,
	cJSON *newitem); /* Shifts pre-existing items to the right. */
extern void cJSON_ReplaceItemInArray(cJSON *array, int which, cJSON *newitem);
extern void cJSON_ReplaceItemInObject(cJSON *object, const char *string,
				      cJSON *newitem);

/* Duplicate a cJSON item */
extern cJSON *cJSON_Duplicate(cJSON *item, int recurse);
/* Duplicate will create a new, identical cJSON item to the one you pass, in new
memory that will need to be released. With recurse!=0, it will duplicate any
children connected to the item. The item->next and ->prev pointers are always
zero on return from Duplicate. */

/* ParseWithOpts allows you to require (and check) that the JSON is null
 * terminated, and to retrieve the pointer to the final byte parsed. */
extern cJSON *cJSON_ParseWithOpts(const char *value,
				  const char **return_parse_end,
				  int require_null_terminated);

extern void cJSON_Minify(char *json);

/* Macros for creating things quickly. */
#define cJSON_AddNullToObject(object, name)                                    \
	cJSON_AddItemToObject(object, name, cJSON_CreateNull())
#define cJSON_AddTrueToObject(object, name)                                    \
	cJSON_AddItemToObject(object, name, cJSON_CreateTrue())
#define cJSON_AddFalseToObject(object, name)                                   \
	cJSON_AddItemToObject(object, name, cJSON_CreateFalse())
#define cJSON_AddBoolToObject(object, name, b)                                 \
	cJSON_AddItemToObject(object, name, cJSON_CreateBool(b))
#define cJSON_AddNumberToObject(object, name, n)                               \
	cJSON_AddItemToObject(object, name, cJSON_CreateNumber(n))
#define cJSON_AddStringToObject(object, name, s)                               \
	cJSON_AddItemToObject(object, name, cJSON_CreateString(s))

/* When assigning an integer value, it needs to be propagated to valuedouble
 * too. */
#define cJSON_SetIntValue(object, val)                                         \
	((object) ? (object)->valueint = (object)->valuedouble = (val) : (val))
#define cJSON_SetNumberValue(object, val)                                      \
	((object) ? (object)->valueint = (object)->valuedouble = (val) : (val))

#ifdef __cplusplus
}
#endif

#endif
```

## include/gcloud.h
```c
#ifndef __MQTT_H__
#define __MQTT_H__

#include <net/mqtt_socket.h>

#define strlens(s) (s==NULL?0:strlen(s))

typedef void (*received_config_handler_t)(const struct mqtt_publish_message *message);

/**
 * @brief Publishes data to Google Cloud.
 * 
 * @param[in] data A pointer to the data to be sent.
 * @param[in] size The size of the data to be sent.
 * @param[in] qos The Quality of Serive level to be used when sending the telemetry.
 * 
 * @note Google Cloud does only support QoS 0 and QoS 1, not QoS 2
 * 
 * @retval 0 or an error code indicating reason for failure.
 */
// CANDO: Make it possible to publish gps to subtopics
int gcloud_publish(u8_t *data, u32_t size, enum mqtt_qos qos);

/**
 * @brief Publishes device state to Google Cloud.
 * 
 * @param[in] data A pointer to the data to be sent.
 * @param[in] size The size of the data to be sent.
 * @param[in] qos The Quality of service level to be used when sending the state.
 * 
 * @note Google Cloud does only support QoS 0 and QoS 1, not Qos 2.
 * @note Google Cloud limits state updates to 1 update per second, per device. 
 *       However, for best results, device state should be updated much less often 
 *       - at most, once every 10 second.
 * 
 * @retval 0 or an error code indicating reson for failure.
 */
int gcloud_publish_state(u8_t *data, u32_t size, enum mqtt_qos qos);

/**
 * @brief Connects the device to Google Cloud, and subscribes to Google Cloud's configuration topic.
 * 
 * @note gcloud_provision must be called before this.
 * @note Shall be called before trying to send data to Google Cloud.
 * @note The modem must be turned on, and connected before this function can be called.
 * 
 * @param[in] received_config_cb Callback function which will be called when a configuration 
 *            update is received from Google Cloud.
 * 
 * @retval - or an error code indicating reason for failure.
 */
// CANDO: make it possible to set keep-alive checks, and input check intervals
// CANDO: make it possible to decide what QoS level the subscription to config should be
int gcloud_connect(received_config_handler_t received_config_cb);

/**
 * @brief Initializes the module and provisions the modem so that an TLS 
 * connection can be established to Google Cloud.
 * 
 * @note Shall be called before the modem is turned on.
 * @note Shall be called before gcloud_connect.
 * @note If module initialization fails, no module APIs shall be called.
 * 
 * @retval 0 or an error code indicating reason for failure.
 */
int gcloud_provision(void);

/**
 * @brief Disconnects the device from Google Cloud.
 * 
 * @retval 0 or an error code indicating reason for failure.
 */
int gcloud_disconnect(void);

#endif /* __MQTT_H__ */
```

## include/ntp.h
```c
#ifndef _NTP_H_
#define _NTP_H_

#include <zephyr.h>
#include <net/socket.h>
#include <stdio.h>
#include <uart.h>
#include <string.h>
#include <time.h>
#include "ntp.h"

struct ntp_format {
	u8_t flags;
	u8_t stratum; /* stratum */
	u8_t poll; /* poll interval */
	s8_t precision; /* precision */
	u32_t rootdelay; /* root delay */
	u32_t rootdisp; /* root dispersion */
	u32_t refid; /* reference ID */
	u32_t reftime_sec; /* reference time */
	u32_t reftime_frac; /* reference time */
	u32_t org_sec; /* origin timestamp */
	u32_t org_frac; /* origin timestamp */
	u32_t rec_sec; /* receive timestamp */
	u32_t rec_frac; /* receive timestamp */
	u32_t xmt_sec; /* transmit timestamp */
	u32_t xmt_frac; /* transmit timestamp */
};

int blocking_recv(int fd, u8_t *buf, u32_t size, u32_t flags);

int blocking_recvfrom(int fd, void *buf, u32_t size, u32_t flags,
		      struct sockaddr *src_addr, socklen_t *addrlen);

int blocking_send(int fd, u8_t *buf, u32_t size, u32_t flags);

int blocking_connect(int fd, struct sockaddr *local_addr, socklen_t len);

void ntp_swap_endianess(struct ntp_format *ntp);

//Function for getting unix time
u32_t ntp_get_unix_time(void);

#endif //_NTP_
```

## src/gcloud.c
```c
#include<logging/log.h>
LOG_MODULE_REGISTER(gcloud);

#include <zephyr.h>
#include <misc/printk.h>
#include <net/socket.h>
#include <net/mqtt_socket.h>
#include <string.h>
#include <errno.h>
#include <zephyr/jwt.h>

#include "nrf_inbuilt_key.h"

#include "gcloud.h"
#include "ntp.h"

#include "globalsign.inc"

#define ROOT_CERT \
    "-----BEGIN CERTIFICATE-----\n" \
    "MIIBdTCCARugAwIBAgIJAOvj4PVfAgqjMAoGCCqGSM49BAMCMBYxFDASBgNVBAMM\n" \
    "C25yZjkxLW1hcnRlMCAXDTE5MDQwNTExMTUxN1oYDzQ3NTcwMzAyMTExNTE3WjAW\n" \
    "MRQwEgYDVQQDDAtucmY5MS1tYXJ0ZTBZMBMGByqGSM49AgEGCCqGSM49AwEHA0IA\n" \
    "BAq8otkWGnocpdAxlnpJdVn6EBb1WbQnZXLFaYzsMeXWGFIIO02hWTvaSUPI1xNs\n" \
    "0QB8c3IU9oBhDXkRNU2Nqi2jUDBOMB0GA1UdDgQWBBRLAhO335CAd280I/qVQmiM\n" \
    "07nd8TAfBgNVHSMEGDAWgBRLAhO335CAd280I/qVQmiM07nd8TAMBgNVHRMEBTAD\n" \
    "AQH/MAoGCCqGSM49BAMCA0gAMEUCIF2kQO7Cqn73ANmwBdgGA1y/KGOpOU4I/ywF\n" \
    "LEu8trOUAiEA8//UWttMRkmaylghw3mgsYGGKk17rY+4j+4mGUwvDnw=\n" \
    "-----END CERTIFICATE-----"

#define GCLOUD_CA_CERTIFICATE ROOT_CERT

#define GCLOUD_ID "projects/" CONFIG_GCLOUD_PROJECT_NAME "/locations/" CONFIG_GCLOUD_REGION "/registries/" CONFIG_GCLOUD_REGISTRY_NAME "/devices/" CONFIG_GCLOUD_DEVICE_NAME

#define GCLOUD_HOSTNAME "mqtt.googleapis.com" 
#define BROKER_ADDR GCLOUD_HOSTNAME
#define BROKER_PORT 8883

#define GCLOUD_SEC_TAG 16842752

#define SUBSCRIBE_ID 42

#define MQTT_INPUT_PERIOD K_SECONDS(2)
#define MQTT_LIVE_PERIOD K_SECONDS(55)
#define GCLOUD_DISCONNECT_INTERVAL K_HOURS(12)
#define INPUT_TIMEOUT_PERIOD K_SECONDS(10)

#define GCLOUD_CONFIG_TOPIC "/devices/" CONFIG_GCLOUD_DEVICE_NAME "/config"

#define GCLOUD_STATE_TOPIC "/devices/" CONFIG_GCLOUD_DEVICE_NAME "/state"

#define GCLOUD_TOPIC "/devices/" CONFIG_GCLOUD_DEVICE_NAME "/events"

#define JWT_BUFFER_SIZE 256

#define GCLOUD_THREAD_STACK_SIZE 2048
#define GCLOUD_THREAD_PRIORITY 7
static void gcloud_thread(void *, void *, void *);
K_THREAD_DEFINE(gcloud_thread_tid, GCLOUD_THREAD_STACK_SIZE, 
                gcloud_thread, NULL, NULL, NULL, 
                GCLOUD_THREAD_PRIORITY, 0, K_NO_WAIT);

enum gcloud_event_type {
    CONNECT,
    INPUT_TIMEOUT,
    LIVE_TIMEOUT,
    PUBLISH_STATE,
    PUBLISH,
    RECONNECT_TIMEOUT,
    DISCONNECT,
    SUBSCRIBE
};

struct empty {};

union gcloud_event_param {
    struct empty connect;
    struct empty input_timeout;
    struct empty live_timeout;
    struct mqtt_publish_message publish_state; // This could be a whole mqtt message, thus allowing custom topics
    struct mqtt_publish_message publish;
    struct empty reconnect_timeout;
    struct empty disconnect;
    struct empty subscribe; // Here we could add the list of topics to be subscribed to
};

struct gcloud_event {
    enum gcloud_event_type type;
    union gcloud_event_param param;
};

static struct mqtt_client client;
static struct sockaddr_storage mqtt_broker;
static struct mqtt_sec_config tls_config;
char jwt_buffer[JWT_BUFFER_SIZE];
static struct mqtt_utf8 jwt_token = {
    .utf8 = jwt_buffer
};
static struct mqtt_utf8 username = {
    .utf8 = "unused",
    .size = sizeof("unused")
};

static struct mqtt_topic gcloud_topics_list[] = {
    {
        .topic = {
            .utf8 = GCLOUD_CONFIG_TOPIC,
            .size = sizeof(GCLOUD_CONFIG_TOPIC) - 1
        },
        .qos = MQTT_QOS_1_AT_LEAST_ONCE
    }
};

/* Private key information */
extern unsigned char zepfull_private_der[];
extern unsigned int zepfull_private_der_len;

static received_config_handler_t received_config_handler = NULL;

#define N_MESSAGES 3
K_MSGQ_DEFINE(gcloud_msgq, sizeof(struct gcloud_event), N_MESSAGES, 4);

static void mqtt_event_handler(struct mqtt_client *client, const struct mqtt_evt *evt);

void input_timer_handler(struct k_timer *timer_id);
void reconnect_timer_handler(struct k_timer *timer_id);
K_TIMER_DEFINE(input_timer, input_timer_handler, NULL);
K_TIMER_DEFINE(reconnect_timer, reconnect_timer_handler, NULL);

int k_msgq_get_atomic(struct k_msgq *q, void *data, s32_t timeout);
int k_msgq_put_atomic(struct k_msgq *q, void *data, s32_t timeout);

static bool connected = false;
static bool connecting = false;



/**@brief Resolves the configured hostname and
 * initializes the MQTT broker structure
 */
static void broker_init(void)
{
	int err;
	struct addrinfo *result;
	struct addrinfo *addr;
	struct addrinfo hints = {
		.ai_family = AF_INET,
		.ai_socktype = SOCK_STREAM
	};

	err = getaddrinfo(GCLOUD_HOSTNAME, NULL, &hints, &result);
	if (err) {
		LOG_ERR("ERROR: getaddrinfo failed %d", err);

		return;
	}

	addr = result;
	err = -ENOENT;

	/* Look for address of the broker. */
	while (addr != NULL) {
		/* IPv4 Address. */
		if (addr->ai_addrlen == sizeof(struct sockaddr_in)) {
			struct sockaddr_in *broker4 =
				((struct sockaddr_in *)&mqtt_broker);

			broker4->sin_addr.s_addr =
				((struct sockaddr_in *)addr->ai_addr)
				->sin_addr.s_addr;
			broker4->sin_family = AF_INET;
			broker4->sin_port = htons(BROKER_PORT);
			LOG_DBG("IPv4 Address found 0x%08x",
				broker4->sin_addr.s_addr);
			break;
		} else {
			LOG_ERR("ai_addrlen = %u should be %u or %u",
				(unsigned int)addr->ai_addrlen,
				(unsigned int)sizeof(struct sockaddr_in),
				(unsigned int)sizeof(struct sockaddr_in6));
		}

		addr = addr->ai_next;
		break;
	}

	/* Free the address. */
	freeaddrinfo(result);
}

static int make_jwt(char *buffer, size_t buffer_size) {
    int err;
    struct jwt_builder jb;

    err = jwt_init_builder(&jb, buffer, buffer_size);
    if (err != 0) {
        LOG_ERR("Unable to init JWT builder: %d", err);
        return err;
    }
    s32_t timestamp = ntp_get_unix_time();
    LOG_DBG("timestamp: %d", timestamp);
    err = jwt_add_payload(&jb, timestamp + 12 * 60 * 60, timestamp, CONFIG_GCLOUD_PROJECT_NAME);
    if (err != 0) {
        LOG_ERR("Unable to add JWT payload: %d", err);
        return err;
    }
    err = jwt_sign(&jb, zepfull_private_der, zepfull_private_der_len);
    if (err != 0) {
        LOG_ERR("Unable to add JWT payload: %d", err);
        return err;
    }
    if (jb.overflowed != 0) {
        LOG_ERR("JWT buffer overflowed");
        return -ENOMEM;
    }
    return err;
}

static int gcloud_subscribe() {
    const struct mqtt_subscription_list subscriptions = {
        .list = (struct mqtt_topic *)&gcloud_topics_list,
        .list_count = ARRAY_SIZE(gcloud_topics_list),
        .message_id = SUBSCRIBE_ID
    };

    return mqtt_subscribe(&client, &subscriptions);
}

static int client_init(void) {
    mqtt_client_init(&client);

    int err = make_jwt(jwt_buffer, JWT_BUFFER_SIZE);
    if (err != 0) {
        LOG_ERR("Unable to make jwt: %d %s", err, strerror(-err));
        return err;
    }

    LOG_DBG("JWT:\n%s\n", log_strdup(jwt_buffer));
    LOG_DBG("JWT length: %d", strlens(jwt_buffer));

    jwt_token.size = strlens(jwt_buffer);

    client.evt_cb = mqtt_event_handler;
    client.client_id.utf8 = GCLOUD_ID;
    client.client_id.size = strlens(GCLOUD_ID);
    client.password = &jwt_token;
    client.user_name = &username;
    client.protocol_version = MQTT_VERSION_3_1_1;

    client.transport.type = MQTT_TRANSPORT_SECURE; 
    struct mqtt_sec_config *client_tls_config = &client.transport.tls.config;
    memcpy(client_tls_config, &tls_config, sizeof(struct mqtt_sec_config));

    client.broker = (struct sockaddr *)&mqtt_broker;

    return 0;
}

int gcloud_provision(void) {
    static sec_tag_t sec_tag_list[] = {GCLOUD_SEC_TAG};

    tls_config.peer_verify = 0;
    tls_config.cipher_count = 0;
    tls_config.cipher_list = NULL;
    tls_config.sec_tag_count = ARRAY_SIZE(sec_tag_list);
    tls_config.seg_tag_list = sec_tag_list;
    tls_config.hostname = GCLOUD_HOSTNAME;

    int err;

    /* Delete certificates */
    nrf_sec_tag_t sec_tag = GCLOUD_SEC_TAG;

    for (nrf_key_mgnt_cred_type_t type = 0; type < 5; type++) {
        err = nrf_inbuilt_key_delete(sec_tag, type);
        if (err) {
            LOG_ERR("key delete err: %d %s", err, strerror(err));
        }
    }
    LOG_DBG("CERT:\n%s\n", GCLOUD_CA_CERTIFICATE);
    /* Provision CA Certificate */
    err = nrf_inbuilt_key_write(
        GCLOUD_SEC_TAG,
        NRF_KEY_MGMT_CRED_TYPE_CA_CHAIN,
        GCLOUD_CA_CERTIFICATE,
        strlens(GCLOUD_CA_CERTIFICATE));
    if (err != 0) {
        LOG_ERR("GCLOUD_CA_CERTIFICATE err: %d %s\n", err, strerror(err));
        return err;
    }

    // This function should probably only be called once.
    err = mqtt_init();
    if (err != 0) {
        return err;
    }

    return 0;
}

int gcloud_connect(received_config_handler_t received_config_cb) {
    int err = 0;
    received_config_handler = received_config_cb;

    // send connect command
    struct gcloud_event msg = {
        .type = CONNECT
    };
    err = k_msgq_put_atomic(&gcloud_msgq, &msg, K_FOREVER);

    return err;
}

int gcloud_disconnect() {
    int err = 0;

    // send disconnect command
    struct gcloud_event msg = {
        .type = DISCONNECT
    };
    err = k_msgq_put_atomic(&gcloud_msgq, &msg, K_FOREVER);

    return err;
}

// CANDO: Merge publish functions, and only have one publish command
// (the public API can still have two separate functions)

int gcloud_publish(u8_t *data, u32_t size, enum mqtt_qos qos)
{
    int err;
    if (!connected) {
        LOG_WRN("Cannot publish data while not connected to Google Cloud");
        return -ENOTCONN;
    }

    struct gcloud_event cmd = {
        .type = PUBLISH,
        .param.publish = {
            .topic = {
                .topic = {
                    .utf8 = GCLOUD_TOPIC,
                    .size = strlens(GCLOUD_TOPIC)
                },
                .qos = qos
            },
            .payload = {
                .data = data,
                .len = size
            }
        }
    };

    err = k_msgq_put_atomic(&gcloud_msgq, &cmd, K_FOREVER);

    return err;
}

int gcloud_publish_state(u8_t *data, u32_t size, enum mqtt_qos qos)
{
    int err;
    if (!connected) {
        LOG_WRN("Cannot publish state while not connected to Google Cloud");
        return -ENOTCONN;
    }
    struct gcloud_event state_cmd = {
        .type = PUBLISH_STATE,
        .param.publish_state = {
            .topic = {
                .topic = {
                    .utf8 = GCLOUD_STATE_TOPIC,
                    .size = strlens(GCLOUD_STATE_TOPIC)
                },
                .qos = qos
            },
            .payload = {
                .data = data,
                .len = size
            }
        }
    };
    err = k_msgq_put_atomic(&gcloud_msgq, &state_cmd, K_FOREVER);
    return err;
}

int k_msgq_get_atomic(struct k_msgq *q, void *data, s32_t timeout){
    unsigned int key = irq_lock();
    int temp = k_msgq_get(q, data,timeout);
    irq_unlock(key);
    return temp;
}

int k_msgq_put_atomic(struct k_msgq *q, void *data, s32_t timeout){
    unsigned int key = irq_lock();
    int temp = k_msgq_put(q,data,timeout);
    irq_unlock(key);
    return temp;
}

void input_timer_handler(struct k_timer *timer_id) {
    struct gcloud_event cmd = {
        .type = INPUT_TIMEOUT,
        .param = {}
    };
    int err = k_msgq_put(&gcloud_msgq, &cmd, K_NO_WAIT);
    if (err) {
        LOG_ERR("k_msgq_put (input_timeout) failed: %d %s", err, strerror(-err));
        // TODO: Find a way to report this error to the application.
    }
}

void reconnect_timer_handler(struct k_timer *timer_id) {
    struct gcloud_event cmd = {
        .type = RECONNECT_TIMEOUT,
        .param = {}
    };
    int err = k_msgq_put(&gcloud_msgq, &cmd, K_NO_WAIT);

    if (err) {
        LOG_ERR("k_msgq_put (reconnect_timeout) failed: %d", err);
        // TODO: Find a way to report this error to the application.
    }
}

static void mqtt_event_handler(struct mqtt_client *client,
                const struct mqtt_evt *evt)
{
    int err;
    LOG_INF("MQTT event: %d", evt->type);

    switch (evt->type) {
        // Response to conneck request
        case MQTT_EVT_CONNACK:
            LOG_DBG("Got CONNACK");
            if (evt->result != 0) {
                LOG_ERR("MQTT connect failed: %d", evt->result);
                break;
            }

            connected = true;
            connecting = false;
            k_timer_start(&reconnect_timer, GCLOUD_DISCONNECT_INTERVAL, GCLOUD_DISCONNECT_INTERVAL);

            struct gcloud_event cmd = {
                .type = SUBSCRIBE,
                .param.subscribe = {}
            };

            err = k_msgq_put_atomic(&gcloud_msgq, &cmd, K_FOREVER);

            if (err) {
                LOG_ERR("k_msgq_put_atomic (subscribe) failed: %d", err);
                // TODO: Find a way to report this error to the application.
            }

            break;

        // A message has been published on a topic we subscribe to.
        case MQTT_EVT_PUBLISH:
            LOG_DBG("MQTT PUBLISH event");
            if (evt->result != 0) {
                LOG_ERR("Publish event error: %d %s", evt->result, strerror(-evt->result));
            }

            if (evt->param.publish.message.topic.qos == MQTT_QOS_1_AT_LEAST_ONCE) {
                const struct mqtt_puback_param ack = {
                    .message_id = evt->param.publish.message_id
                };

                /* Send acknowledgement. */
                mqtt_publish_qos1_ack(client, &ack);
                LOG_INF("Send acknowledgement");
            }

            if(evt->param.publish.message.payload.len <= 2) {
                LOG_WRN("Received empty payload");
                break;
            }

            LOG_DBG("Length of payload: %d", evt->param.publish.message.payload.len);
            LOG_DBG("Topic: %s", log_strdup(evt->param.publish.message.topic.topic.utf8));
            LOG_DBG("QoS: %d", evt->param.publish.message.topic.qos);
            LOG_DBG("Message:\n");

            struct mqtt_evt event = *evt;

            char * str = calloc(evt->param.publish.message.payload.len, sizeof(char) + 1);
            memcpy(str, evt->param.publish.message.payload.data, evt->param.publish.message.payload.len);
            event.param.publish.message.payload.data = str;

            if (received_config_handler != NULL) {
                received_config_handler(&event.param.publish.message);
            }

            free(str);
            break;

        // Dissconnect event. MQTT Client Reference is no longer valid.
        case MQTT_EVT_DISCONNECT:
            LOG_DBG("MQTT client disconnected: %d %s", evt->result, strerror(-evt->result));
            k_timer_stop(&input_timer);
            k_timer_stop(&reconnect_timer);
            // If we are connected, something has gone wrong, and we would like to reconnect
            // CANDO: Notify the application that we are attempting a reconnect
            
            // Purging message queue to make sure that there are no old messages waiting

            k_msgq_purge(&gcloud_msgq);


            if (connected || connecting) {
                err = gcloud_connect(received_config_handler);
                if (err) {
                    LOG_ERR("k_msgq_put_atomic (reconnect) failed: %d", err);
                    // TODO: Find a way to report this error to the application.
                }
            }
            break;

        // Acknowledgement for QoS 1 messages.
        case MQTT_EVT_PUBACK:
            if (evt->result != 0) {
                LOG_ERR("MQTT PUBACK error: %d", evt->result);
                break;
            }

            LOG_DBG("PUBACK packet id: %d\n", evt->param.puback.message_id);

            break;

        // Reception confirmation for messages with QoS 2.
        case MQTT_EVT_PUBREC:
            if (evt->result != 0) {
                LOG_ERR("MQTT PUBREC error: %d", evt->result);
                break;
            }

            LOG_DBG("PUBREC packet id: %u", evt->param.pubrec.message_id);

            const struct mqtt_pubrel_param rel_param = {
                .message_id = evt->param.pubrec.message_id
            };

            err = mqtt_publish_qos2_release(client, &rel_param);
            if (err != 0) {
                LOG_ERR("Failed to send MQTT PUBREL: %d", err);
            }

            break;

        // Release of messages with QoS 2.
        case MQTT_EVT_PUBREL:
            LOG_DBG("MQTT PUBREL event");
            if (evt->result != 0) {
                LOG_ERR("PUBREL error: %d", evt->result);
                break;
            }
            break;

        // Confirmation to publish 
        case MQTT_EVT_PUBCOMP:
            if (evt->result != 0) {
                LOG_ERR("MQTT PUBCOMP error: %d", evt->result);
                break;
            }

            LOG_DBG("PUBCOMP packet id: %u", evt->param.pubcomp.message_id);

            break;

        // Acknowledgment of a subscription request.
        case MQTT_EVT_SUBACK:
            LOG_DBG("Got SUBACK");
            if (evt->result != 0) {
                LOG_ERR("MQTT SUBACK error: %d", evt->result);
                break;
            }

            break;

        // Acknowledgment of a unsubscribe request.
        case MQTT_EVT_UNSUBACK:
            LOG_DBG("MQTT UNSUBACK event");
            if (evt->result != 0) {
                LOG_ERR("MQTT UNSUBACK error: %d", evt->result);
                break;
            }

            break;
        
        default:
            LOG_ERR("Unknown mqtt event type");
            break;
    }
}

static void gcloud_thread(void *unused1, void *unused2, void *unused3) {
    int err;

    struct gcloud_event event;
    struct mqtt_publish_param msg;

    k_timer_init(&input_timer, input_timer_handler, NULL);
    k_timer_init(&reconnect_timer, reconnect_timer_handler, NULL);

    while (true) {
        printk("GCLOUD THREAD LIVES\n");

        k_msgq_get_atomic(&gcloud_msgq, &event, K_FOREVER);

        switch (event.type) {
            case CONNECT:
                LOG_INF("Got CONNECT command");
                LOG_DBG("Initiating broker");
                broker_init();
                LOG_DBG("Making JWT");
                make_jwt(jwt_buffer, JWT_BUFFER_SIZE);
                LOG_DBG("Initiating client");
                client_init();
                LOG_DBG("Starting input timer");
                k_timer_start(&input_timer, INPUT_TIMEOUT_PERIOD, INPUT_TIMEOUT_PERIOD);
                LOG_DBG("Connecting mqtt");
                connecting = true;
                err = mqtt_connect(&client);
                if (err) {
                    LOG_ERR("mqtt_connect failed: %d %s", err, strerror(-err));
                    // TODO: Find a way to report this error to the application.
                }

                break;
            case INPUT_TIMEOUT:
                LOG_INF("Got INPUT_TIMEOUT command");
                err = mqtt_input(&client);
                if (err) {
                    LOG_ERR("mqtt_input failed: %d", err);
                    // TODO: Find a way to report this error to the application.
                } 
            break;
            case LIVE_TIMEOUT:
            if (connected) {
                LOG_INF("Got LIVE_TIMEOUT command");
                err = mqtt_live();
                if (err) {
                    LOG_ERR("mqtt_live failed: %d", err);
                    // TODO: Find a way to report this error to the application.
                }
            }
            break;
            case PUBLISH_STATE:
            if (connected) {
                LOG_INF("Got PUBLISH_STATE command");
                msg.message = event.param.publish_state;
                msg.message_id = sys_rand32_get();
                msg.dup_flag = 0;
                msg.retain_flag = 0;
                err = mqtt_publish(&client, &msg);
                
                if (err) {
                    LOG_ERR("mqtt_publish (state) failed: %d", err);
                    // TODO: Find a way to report this error to the application.
                }
            };
            break;
            // CANDO: Merge these publish cases?
            case PUBLISH:
            if (connected) {
                LOG_INF("Got PUBLISH command");
                msg.message = event.param.publish;
                msg.message_id = sys_rand32_get();
                msg.dup_flag = 0;
                msg.retain_flag = 0;
                err = mqtt_publish(&client, &msg);
                if (err) {
                    LOG_ERR("mqtt_publish failed: %d", err);
                    // TODO: Find a way to report this error to the application.
                }
            };
            break;
            case RECONNECT_TIMEOUT:
                LOG_INF("Got RECONNECT_TIMEOUT command");
            case DISCONNECT:
                LOG_INF("Got DISCONNECT command");
            if (connected) {
                k_timer_stop(&reconnect_timer);
                LOG_DBG("Disconnecting mqtt");
                err = mqtt_disconnect(&client);
                if (err) {
                    LOG_ERR("mqtt_disconnect (reconnect) failed: %d", err);
                    // TODO: Find a way to report this error to the application.
                }
                // purge message queue (if asynchrounous)

                k_msgq_purge(&gcloud_msgq);

                connected = false;
                if (event.type == DISCONNECT) {
                    LOG_DBG("Not setting connecting flag");
                    connecting = false;
                } else {
                    connecting = true;
                }

            };
            break;
            case SUBSCRIBE:
            if (connected) {
                LOG_INF("Got SUBSCRIBE command");
                err = gcloud_subscribe();
                if (err) {
                    LOG_ERR("gcloud_subscribe failed: %d", err);
                    // TODO: Find a way to report this error to the application.
                }
            };
            break;
            default:
                LOG_ERR("Unknown event type received");
                // TODO: Find a way to report this error to the application.
        }
    }
}
```

## src/ntp.c
```c
/*
 * Copyright (c) 2018 Nordic Semiconductor ASA
 *
 * SPDX-License-Identifier: LicenseRef-BSD-5-Clause-Nordic
 */

#include <zephyr.h>
#include <net/socket.h>
#include <stdio.h>
#include <uart.h>
#include <string.h>
#include <time.h>
#include "ntp.h"

#define NTP_HOST "ntp.uio.no"
#define NTP_PORT 123
#define RECV_BUF_SIZE 1024

/* Chapter 3: https://www.eecis.udel.edu/~mills/y2k.html 
 * Need to convert from 1900 -> 1970
 */
#define NTP_TO_UNIX_OFFSET 2208988800ULL

char recv_buf[RECV_BUF_SIZE];



int blocking_recv(int fd, u8_t *buf, u32_t size, u32_t flags)
{
	int err;

	do {
		err = recv(fd, buf, size, flags);
	} while (err < 0 && errno == EAGAIN);

	return err;
}

int blocking_recvfrom(int fd, void *buf, u32_t size, u32_t flags,
		      struct sockaddr *src_addr, socklen_t *addrlen)
{
	int err;

	do {
		err = recvfrom(fd, buf, size, flags, src_addr, addrlen);
	} while (err < 0 && errno == EAGAIN);

	return err;
}

int blocking_send(int fd, u8_t *buf, u32_t size, u32_t flags)
{
	int err;

	do {
		err = send(fd, buf, size, flags);
	} while (err < 0 && errno == EAGAIN);

	return err;
}

int blocking_connect(int fd, struct sockaddr *local_addr, socklen_t len)
{
	int err;

	do {
		err = connect(fd, local_addr, len);
	} while (err < 0 && errno == EAGAIN);

	return err;
}

void ntp_swap_endianess(struct ntp_format *ntp)
{
	if (ntp) {
		ntp->org_frac = htonl(ntp->org_frac);
		ntp->org_sec = htonl(ntp->org_sec);
		ntp->reftime_frac = htonl(ntp->reftime_frac);
		ntp->reftime_sec = htonl(ntp->reftime_sec);
		ntp->rec_frac = htonl(ntp->rec_frac);
		ntp->rec_sec = htonl(ntp->rec_sec);
		ntp->xmt_frac = htonl(ntp->xmt_frac);
		ntp->xmt_sec = htonl(ntp->xmt_sec);
	}
}


u32_t ntp_get_unix_time(void)
{
	struct addrinfo *res;
  	struct addrinfo hints = {
		.ai_family = AF_INET,
		.ai_socktype = SOCK_DGRAM
	};
	struct ntp_format ntp = { 0 };
	socklen_t addrlen = sizeof(struct sockaddr_storage);
	
	ntp.flags = 0xe3;
	int err = getaddrinfo(NTP_HOST, NULL, &hints, &res);

	//printk("getaddrinfo err: %d\n\r", err);
	((struct sockaddr_in *)res->ai_addr)->sin_port = htons(NTP_PORT);
	struct sockaddr_in local_addr;

	local_addr.sin_family = AF_INET;
	local_addr.sin_port = htons(0);
	local_addr.sin_addr.s_addr = 0;

	int client_fd = socket(AF_INET, SOCK_DGRAM, 0);
	//printk("client_fd: %d\n\r", client_fd);

	err = bind(client_fd, (struct sockaddr *)&local_addr,
		   sizeof(local_addr));
	//printk("bind err: %d\n\r", err);

	err = blocking_connect(client_fd, (struct sockaddr *)res->ai_addr,
			       sizeof(struct sockaddr_in));
	if (err < 0) {
		printk("connect err: %d\n\r", errno);
	}
	
	err = send(client_fd, &ntp, sizeof(struct ntp_format), 0);
	//printk("sendto ret: %d\n\r", err);
	if (err < 0) {
		printk("sendto err: %d\n\r", errno);
	}

	err = blocking_recvfrom(client_fd, &ntp, sizeof(struct ntp_format), 0,
				(struct sockaddr *)res->ai_addr, &addrlen);
	if (err < 0) {
		printk("recvfrom err: %d\n\r", errno);
	}
	ntp_swap_endianess(&ntp);

	u32_t unix_time = ntp.xmt_sec - NTP_TO_UNIX_OFFSET;

	(void)close(client_fd);
	return unix_time;
}
```
