## prj.conf
```kconfig
# App config
CONFIG_GCLOUD_LOG_LEVEL=4
CONFIG_WATCHDOG=n
CONFIG_ASSERT=y
CONFIG_REBOOT=y
CONFIG_AT_HOST_LIBRARY=y

# General config
CONFIG_NEWLIB_LIBC_FLOAT_PRINTF=y
CONFIG_NEWLIB_LIBC=y
CONFIG_CJSON_LIB=y

# Debug settings
CONFIG_SERIAL=y
CONFIG_LOG=y
CONFIG_LOG_PRINTK=n
CONFIG_LOG_DEFAULT_LEVEL=4
# CONFIG_LOG_BACKEND_SHOW_COLOR=y
# CONFIG_LOG_BACKEND_UART=y
# CONFIG_LOG_BACKEND_RTT=n

# # Optimisation
# CONFIG_NO_OPTIMIZATIONS=y
# CONFIG_DEBUG=y

# Expand logging memory to avoid log_strdup() errors
CONFIG_LOG_STRDUP_MAX_STRING=256
CONFIG_LOG_STRDUP_BUF_COUNT=12

# LTE link control
CONFIG_LTE_LINK_CONTROL=y
CONFIG_LTE_AUTO_INIT_AND_CONNECT=n
CONFIG_LTE_LINK_CONTROL_LOG_LEVEL_DBG=n

CONFIG_LTE_NETWORK_MODE_NBIOT=n
CONFIG_LTE_NETWORK_MODE_LTE_M=y
CONFIG_LTE_NETWORK_USE_FALLBACK=n

CONFIG_DATE_TIME_UPDATE_INTERVAL_SECONDS=0

CONFIG_LTE_LEGACY_PCO_MODE=n
CONFIG_LTE_PSM_REQ_RPTAU="00000110"
CONFIG_LTE_PSM_REQ_RAT="00000010"
# CONFIG_LTE_PSM_REQ_RPTAU="10100000"
# CONFIG_LTE_PSM_REQ_RAT="11100000"

# BSD library
CONFIG_BSD_LIBRARY=y
CONFIG_DATE_TIME=y
CONFIG_DATE_TIME_MODEM=y
CONFIG_DATE_TIME_UPDATE_INTERVAL_SECONDS=3600
CONFIG_SNTP=y
CONFIG_FP_HARDABI=y
# CONFIG_DATE_TIME_LOG_LEVEL_DBG=y

# Disable Modem traces, since we need UART1 for HCI
CONFIG_BSD_LIBRARY_TRACE_ENABLED=n

# Networking
CONFIG_NETWORKING=y
CONFIG_NET_NATIVE=y
# CONFIG_NET_LOG=y

CONFIG_NET_SOCKETS=y
CONFIG_NET_SOCKETS_OFFLOAD=y
CONFIG_NET_SOCKETS_POSIX_NAMES=y
# CONFIG_NET_SOCKETS_LOG_LEVEL_DBG=y

CONFIG_NET_IPV4=y
CONFIG_NET_IPV6=n
CONFIG_NET_TCP=y
CONFIG_NET_UDP=y

# nRF9160 helper libraries
CONFIG_MODEM_KEY_MGMT=y
CONFIG_DNS_RESOLVER=y
CONFIG_MODEM_INFO=y

# Main thread
CONFIG_MAIN_THREAD_PRIORITY=7
CONFIG_UART_INTERRUPT_DRIVEN=y

# Google Cloud
CONFIG_GCLOUD_REGION="europe-west1"
CONFIG_GCLOUD_PROJECT_NAME="nordicoasys"
CONFIG_GCLOUD_REGISTRY_NAME="OasysFleet"
CONFIG_GCLOUD_DEVICE_NAME="einarnrf9160dk"

# JSON
CONFIG_JSON_LIBRARY=y

# JWT
CONFIG_JWT=y
CONFIG_JWT_SIGN_ECDSA=y

# MQTT
CONFIG_MQTT_LIB=y
CONFIG_MQTT_LIB_TLS=y
CONFIG_MQTT_MESSAGE_BUFFER_SIZE=1024
CONFIG_MQTT_PAYLOAD_BUFFER_SIZE=1024

# Heap and stacks
CONFIG_HEAP_MEM_POOL_SIZE=16384
CONFIG_MAIN_STACK_SIZE=8192
CONFIG_SYSTEM_WORKQUEUE_STACK_SIZE=2048
CONFIG_HW_STACK_PROTECTION=y

# Enable settings storage
CONFIG_SETTINGS=y
```

## src/main.c
```c
/*
 * Copyright (c) 2020 Safecility.com
 * Author: tad@safecility.com
 */

#include <zephyr.h>
#include <device.h>

#include <stdio.h>
#include <stdlib.h>
#include <string.h>
#include <errno.h>

#include <power/reboot.h>

#include <nrf_modem.h>
#include <modem/lte_lc.h>
#include <modem/modem_info.h>

#include <nrf_socket.h>
#include <net/socket.h>
#include <net/mqtt.h>

#include <date_time.h>
#include <gcloud.h>
#include <cJSON.h>

/* Size of buffer determines update rate */
#define MAX_MESSAGE_SIZE 256

struct app_message
{
    char data[MAX_MESSAGE_SIZE];
    size_t len;
};

/* Register main module log */
LOG_MODULE_REGISTER(google_mqtt, CONFIG_GCLOUD_LOG_LEVEL);

k_tid_t gc_tid;

struct m_info_t
{
    char cid[30];
    char tac[30];
    char rssi[30];
    char apn[60];
    char fwv[60];
    uint16_t vltg;
    uint16_t temp;
};

/* Semaphores */
static K_SEM_DEFINE(date_time_ok, 0, 1);

/* Global Variables */

/* Forward declarations of functions */
static void store_modem_configuration(void);

/* Handlers */
void button_handler(uint32_t button_state, uint32_t has_changed)
{
    LOG_INF("Button event: %x  %x\n", button_state, has_changed);
    if ((has_changed & 0x01) && (button_state & 0x01))
    {
        store_modem_configuration();
    }
}

/**@brief Handler for when receiving data from Google Cloud */
void received_config_handler(const struct mqtt_publish_message *message)
{

    cJSON *data_json = cJSON_Parse(message->payload.data);
    cJSON_Print(data_json);
    cJSON_Delete(data_json);
}

/**@brief Configures modem to provide LTE link. Blocks until link is
 * successfully established
 */
static void modem_configure(void)
{
    if (IS_ENABLED(CONFIG_LTE_AUTO_INIT_AND_CONNECT))
    {
        /* Do nothing, modem is already turned on and connected */
    }
    else
    {
        int err;

        //LOG_INF("Enabling PSM\n");
        /* Enable PSM mode */
        //lte_lc_psm_req(true);

        LOG_INF("Establishing LTE link\n");
        err = lte_lc_init_and_connect();
        __ASSERT(err == 0, "LTE link could not be established. Rebooting\n");
    }
}

/**@brief Soft boots modem to store current values to NVM */
void store_modem_configuration(void)
{
    int err;

    LOG_INF("Storing modem configuration\n");
    err = lte_lc_power_off();
    if (err)
    {
        LOG_INF("Fail turning off modem: %d\n", err);
    }
    LOG_INF("Modem offline, turning back on\n");

    err = lte_lc_normal();
    if (err)
    {
        LOG_INF("Fail turning on modem: %d\n", err);
    }
    LOG_INF("Done\n");
}

/**@brief Return modem information */
void get_modem_info(struct m_info_t *info)
{
    LOG_INF("Getting modem info\n");
    modem_info_string_get(MODEM_INFO_CELLID, info->cid, sizeof(info->cid));
    modem_info_string_get(MODEM_INFO_AREA_CODE, info->tac, sizeof(info->tac));
    modem_info_string_get(MODEM_INFO_RSRP, info->rssi, sizeof(info->rssi));
    modem_info_string_get(MODEM_INFO_APN, info->apn, sizeof(info->apn));
    modem_info_string_get(MODEM_INFO_FW_VERSION, info->fwv, sizeof(info->fwv));
    modem_info_short_get(MODEM_INFO_BATTERY, &info->vltg);
    modem_info_short_get(MODEM_INFO_TEMP, &info->temp);
}

void date_time_handler(const struct date_time_evt *evt)
{

    switch (evt->type)
    {
    case DATE_TIME_OBTAINED_MODEM:
        LOG_DBG("DATE_TIME: got time from modem.\n");
        k_sem_give(&date_time_ok);
        break;
    case DATE_TIME_OBTAINED_NTP:
        LOG_DBG("DATE_TIME: got time from NTP.\n");
        k_sem_give(&date_time_ok);
        break;
    case DATE_TIME_OBTAINED_EXT:
        LOG_DBG("DATE_TIME: got time from external.\n");
        k_sem_give(&date_time_ok);
        break;
    case DATE_TIME_NOT_OBTAINED:
        LOG_DBG("DATE_TIME: failed to get time.\n");
        k_sem_give(&date_time_ok);
        break;
    default:
        break;
    }
}

void create_message(struct app_message *destination, uint8_t *data, size_t len, int64_t *timestamp)
{

    cJSON *message;

    message = cJSON_CreateObject();

    cJSON_AddStringToObject(message, "type", "test message");

    char time_str[16];
    snprintf(time_str, 16, "%lld", *timestamp);

    char data_str[len];
    snprintf(data_str, len, "%s", data);

    cJSON_AddStringToObject(message, "timestamp", time_str);
    cJSON_AddStringToObject(message, "data", data);

    destination->len = strlen(cJSON_Print(message));

    strcpy(destination->data, cJSON_Print(message));

    cJSON_Delete(message);
}

/**@brief Thread initialisation */
void main(void)
{
    int err;

    LOG_INF("Google Cloud app started");

    LOG_INF("Initializing modem\n");
    modem_configure();

    LOG_INF("Initializing modem info\n");
    // modem_info_init();

    date_time_update_async(date_time_handler);
    k_sem_take(&date_time_ok, K_FOREVER);

    err = gcloud_provision();
    if (err)
    {
        LOG_ERR("Provisioning failed, error: %d\n", err);
        /* Reboot */
        sys_reboot(0); //TODO: Handle error
    }

    /* Connect to Google Cloud */
    LOG_INF("Connecting to Google Cloud\n");
    err = gcloud_connect(received_config_handler);
    if (err)
    {
        LOG_ERR("Failed to connect to Google Cloud, error: %d\n", err);
        /* Reboot */
        sys_reboot(0); //TODO: Handle error
    }
    else
    {
        LOG_INF("Connected to Google Cloud\n");
    }

    bool data_sent = false;
    while (true)
    {
        app_mqtt_gcloud();
        if (!data_sent)
        {
            /* PUBLISH */
            //Get timestamp
            int64_t curr_time;
            date_time_now(&curr_time);

            struct app_message message;
            create_message(&message, "x", sizeof("x"), &curr_time);

            int pub_success;
            pub_success = gcloud_publish(message.data, message.len, MQTT_QOS_1_AT_LEAST_ONCE);
            if (pub_success != 0)
            {
                LOG_INF("JSON data Publish failed\n");
            }

            data_sent = true;

            // k_sleep(K_SECONDS(10));
            /* PUBLISH END */
        }
    }

    app_mqtt_disconnect();
}
```

## include/gcloud.h
```c
#ifndef __MQTT_H__
#define __MQTT_H__

#include <net/mqtt.h>

typedef void (*received_config_handler_t)(const struct mqtt_publish_message *message);

/**
 * @brief Publishes data to Google Cloud.
 * 
 * @param[in] data A pointer to the data to be sent.
 * @param[in] size The size of the data to be sent.
 * @param[in] qos The Quality of Serive level to be used when sending the telemetry.
 * 
 * @note Google Cloud does only support QoS 0 and QoS 1, not QoS 2
 * 
 * @retval 0 or an error code indicating reason for failure.
 */
// CANDO: Make it possible to publish gps to subtopics
int gcloud_publish(uint8_t *data, uint32_t len, enum mqtt_qos qos);

/**
 * @brief Publishes device state to Google Cloud.
 * 
 * @param[in] data A pointer to the data to be sent.
 * @param[in] size The size of the data to be sent.
 * @param[in] qos The Quality of service level to be used when sending the state.
 * 
 * @note Google Cloud does only support QoS 0 and QoS 1, not Qos 2.
 * @note Google Cloud limits state updates to 1 update per second, per device. 
 *       However, for best results, device state should be updated much less often 
 *       - at most, once every 10 second.
 * 
 * @retval 0 or an error code indicating reson for failure.
 */
int gcloud_publish_state(uint8_t *data, uint32_t size, enum mqtt_qos qos);

/**
 * @brief Connects the device to Google Cloud, and subscribes to Google Cloud's configuration topic.
 * 
 * @note gcloud_provision must be called before this.
 * @note Shall be called before trying to send data to Google Cloud.
 * @note The modem must be turned on, and connected before this function can be called.
 * 
 * @param[in] received_config_cb Callback function which will be called when a configuration 
 *            update is received from Google Cloud.
 * 
 * @retval - or an error code indicating reason for failure.
 */
// CANDO: make it possible to set keep-alive checks, and input check intervals
// CANDO: make it possible to decide what QoS level the subscription to config should be
int gcloud_connect(received_config_handler_t received_config_cb);

int gcloud_subscribe(void);
/**
 * @brief Initializes the module and provisions the modem so that an TLS 
 * connection can be established to Google Cloud.
 * 
 * @note Shall be called before the modem is turned on.
 * @note Shall be called before gcloud_connect.
 * @note If module initialization fails, no module APIs shall be called.
 * 
 * @retval 0 or an error code indicating reason for failure.
 */
int gcloud_provision(void);

/**
 * @brief Disconnects the device from Google Cloud.
 * 
 * @retval 0 or an error code indicating reason for failure.
 */
int gcloud_disconnect(void);

/**
 * @brief Google Cloud Thread entry.
 */
extern void gcloud_thread(void *unused1, void *unused2, void *unused3);

#endif /* __MQTT_H__ */

int app_mqtt_gcloud(void);

int app_mqtt_disconnect(void);
```
