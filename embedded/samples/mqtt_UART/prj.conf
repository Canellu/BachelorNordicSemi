## CMakeLists.txt
```
#
# Copyright (c) 2018 Nordic Semiconductor ASA
#
# SPDX-License-Identifier: LicenseRef-BSD-5-Clause-Nordic
#

cmake_minimum_required(VERSION 3.13.1)
list(APPEND BOARD_ROOT ${CMAKE_CURRENT_SOURCE_DIR})

find_package(Zephyr REQUIRED HINTS $ENV{ZEPHYR_BASE})
project(mqtt-simple)

# NORDIC SDK APP START

target_sources(app PRIVATE
    src/main.c
    src/app_button.c
    src/app_mqtt.c
    src/app_uart.c

    
    include/app_button.h
    include/app_mqtt.h
    include/app_uart.h
    )

zephyr_include_directories(include)

# NORDIC SDK APP END
```

## prj.conf
```kconfig
#
# Copyright (c) 2020 Nordic Semiconductor ASA
#
# SPDX-License-Identifier: LicenseRef-BSD-5-Clause-Nordic
#
CONFIG_STDOUT_CONSOLE=y
CONFIG_NEWLIB_LIBC=y
CONFIG_NEWLIB_LIBC_FLOAT_PRINTF=y
CONFIG_AT_CMD=y
CONFIG_AT_NOTIF=y

# Networking
CONFIG_NETWORKING=y
CONFIG_NET_NATIVE=n
CONFIG_NET_SOCKETS_OFFLOAD=y
CONFIG_NET_SOCKETS=y
CONFIG_NET_SOCKETS_POSIX_NAMES=y

# LTE link control
CONFIG_LTE_LINK_CONTROL=y
CONFIG_LTE_AUTO_INIT_AND_CONNECT=n

# BSD library
CONFIG_BSD_LIBRARY=y

# AT Host
CONFIG_UART_INTERRUPT_DRIVEN=y
CONFIG_AT_HOST_LIBRARY=y

# MQTT
CONFIG_MQTT_LIB=y
CONFIG_MQTT_LIB_TLS=n
CONFIG_MQTT_CLEAN_SESSION=y

# Application
CONFIG_MQTT_PUB_TOPIC="projects/nordicoasys/topics/data"
CONFIG_MQTT_SUB_TOPIC="projects/nordicoasys/topics/commands"
CONFIG_MQTT_CLIENT_ID="einarNrf9160"
CONFIG_MQTT_BROKER_HOSTNAME="broker.mqttdashboard.com"
CONFIG_MQTT_BROKER_PORT=1883

# Button support
CONFIG_DK_LIBRARY=y

# Enable logging
CONFIG_LOG=y
CONFIG_MQTT_SIMPLE_LOG_LEVEL_DBG=y

# Memory
CONFIG_MAIN_STACK_SIZE=4096
CONFIG_HEAP_MEM_POOL_SIZE=2048

CONFIG_DK_LIBRARY_INVERT_LEDS=n
# CONFIG_DK_LIBRARY_INVERT_BUTTONS=n

# UART
CONFIG_GPIO=y
CONFIG_SERIAL=y
```

## src/main.c
```c
#include <zephyr.h>
#include <dk_buttons_and_leds.h>
#include <string.h>
#include <kernel.h>

#include "app_mqtt.h"
#include "app_button.h"
#include "app_uart.h"


/* STRUCTS AND ENUMS */

// Enumerations
enum oasys_event_type { // currently not in use
	EVT_INIT,
	EVT_UART,
	EVT_MQTT
};

// Structs
struct prog_param_t { // currently not in use
	bool bttn_init;
	bool leds_init;
	bool uart_init;
	bool mqtt_init;
} prog_p;

struct sens_param_t { // currently not in use
	int freq_temp;
	int freq_pres;
	int freq_cond;
} sens_p;

struct oasys_param_t { // currently not in use
	int cycle_max;
	int cycle_cur;
	int depth_max;
	int depth_min;
	int wp_max;
	int wp_cur;
	struct prog_param_t prog_param;
	struct sens_param_t sens_param;
} oasys_p;


/* VARIABLE DECLARATIONS */

// button variables
struct k_msgq button_msg_q;
struct k_msgq button_msg_qr;
uint8_t button_msgq_buffer[3 * sizeof(int)];
int button_config;  // value sent to button, TODO: create enum?
					// 0: main
					// 1: uart
					// 2: mqtt
int button_val; // value received from button, only used when button_config = 0


// UART variables
struct k_msgq uart_msg_q;
uint8_t uart_msgq_buffer[128 * 3];
uint8_t uart_msg[128];
uint8_t uart_data_array[16][128] = { "" };

// MQTT variables
struct k_msgq mqtt_msg_q;
uint8_t mqtt_msgq_buffer[128 * 3];
uint8_t mqtt_msg[128];

bool mqtt_init_complete = false;
bool data_available_to_send = false;


/* FUNCTION DECLARATIONS */

// publish all data that is currently saved from uart
int publish_uart_data() 
{
	int i = 0;

	while(strcmp(uart_data_array[i], "") != 0) {
		app_data_publish(uart_data_array[i], strlen(uart_data_array[i])+1);
		k_sleep(K_MSEC(500));
		i++;
	}
	return 0;
}

int check_mqtt_msg(void *data, size_t len)
{
	int ret_value = 0;

    if(strcmp(data, "LED") == 0) {
		toggle_LED(1);
    }

	if (strcmp(data, "exit") == 0) {
		ret_value = 1;
	}

	else if (strcmp(data, "button 2") == 0) {
		ret_value = 2;
	}

	return ret_value;
}

// changes button configuration
int set_button_config(int local_button_config)
{
	k_msgq_purge(&button_msg_q);
	k_msgq_put(&button_msg_q, &local_button_config, K_NO_WAIT);

	return 0;
}

// waiting function, waits for button 1 to be pressed
int button_wait()
{
	set_button_config(0);
	while(1) {
		k_msgq_get(&button_msg_qr, &button_val, K_FOREVER);
		if(button_val == 1) {
			break;
		}
	}

	return 0;
}

/* MAIN */

void main(void)
{

	/* device inits and configurations */

	// buttons and leds
	button_dev_init();
	dk_leds_init();

	k_msgq_init(&button_msg_q, button_msgq_buffer, sizeof(int), 3);
	k_msgq_init(&button_msg_qr, button_msgq_buffer, sizeof(int), 3);

	// UART
	uart_dev_init();

	k_msgq_init(&uart_msg_q, uart_msgq_buffer, sizeof(uart_msg), 3);

	// MQTT
	k_msgq_init(&mqtt_msg_q, mqtt_msgq_buffer, sizeof(mqtt_msg), 3);

	
	/******* PROGRAM START *******/

	printk("\n\n**** NordicOasys v0.5 - Started ****\n\n");
	printk("press button 1 to start\n\n");

	button_wait();

	/******* MAIN LOOP START *******/

	while(1) {

		/******* UART START *******/

		int i = 0;
		while(strcmp(uart_data_array[i], "") != 0) {
			strcpy(uart_data_array[i], "");
			i++;
		}

		// CANDO: create function to purge and clear message queue / messages
		k_msgq_purge(&button_msg_q);
		k_msgq_purge(&uart_msg_q);
		k_msgq_purge(&mqtt_msg_q);

		set_button_config(1);

		uart_start();

		printk("\nuart test start\n");
		printk("button 1: exit \nbutton 2: send uart signal\n\n");

		/* UART loop */
		for (i = 0;; i++) {
			k_msgq_get(&uart_msg_q, &uart_msg, K_FOREVER);

			// TODO: create function to check uart msg similar to mqtt

			if (strcmp(uart_msg, "{exit}") == 0) {
				uart_exit();
				data_available_to_send = true;
				break;
			}
			else {
				// printk("\nUART message: %s", uart_msg);
				strcpy(uart_data_array[i], uart_msg);
			}
		}
		/* UART loop end */
		
		if(strcmp(uart_data_array[0], "") != 0) {
			i = 0;
			while(strcmp(uart_data_array[i], "") != 0){
				printk("\nArray %d: %s", i, uart_data_array[i]);
				i++;
			}
		}
		else {
			printk("no data saved\n");
		}

		printk("\nuart test end\n\n");		
		printk("\n\npress button 1 to start mqtt test\n\n");

		button_wait();

		/******* MQTT START *******/

		set_button_config(2);

		printk("mqtt test start\n");

		int err;

		if(!mqtt_init_complete) {

			err = app_mqtt_init_and_connect();
			if (err != 0) {
				return;
			}

			mqtt_init_complete = true;
		}
		else {

			err = app_mqtt_connect();
			if (err != 0) {
				return;
			}
		}

		// TODO: store mqtt commands into an array
		/* MQTT loop */
		while (1) {
			err = app_mqtt_run();

			k_msgq_get(&mqtt_msg_q, &mqtt_msg, K_NO_WAIT);

			int mqtt_val = check_mqtt_msg(&mqtt_msg, sizeof(mqtt_msg));

			if (mqtt_val == 1 || err != 0) {
				strcpy(mqtt_msg, "");
				break;
			}
			else if (mqtt_val == 2) {

				printk("button choice: 2\n\n");
				strcpy(mqtt_msg, "");
			}

			if (data_available_to_send) {
				publish_uart_data();
				data_available_to_send = false;
			}
		} 
		/* MQTT loop end */

		err = app_mqtt_disconnect();
		if (err != 0) {
			printk("\nDisconnect unsuccessful: %d", err);
			printk("\n\nClosing program, check for errors in code lol");
			return;
		}

		printk("**** NordicOasys test end ****\n");

	}
	/******* MAIN LOOP END *******/
}

/* Function ideas and TODOs

- Allow option to choose between "main parts" 
  e.g. using switch case to choose between UART and MQTT.

- Fill up dev_param struct. Should contain parameters set by user.
  Should be changeable through MQTT.

*/
```

## include/app_button.h
```c
#pragma once
#ifndef _APP_BUTTON_H_
#define _APP_BUTTON_H_

void button_dev_init(void);
int toggle_LED(int led_val);

#endif
```

## include/app_uart.h
```c
#pragma once
#ifndef _APP_UART_H_
#define _APP_UART_H_

void uart_dev_init(void);
void uart_start(void);
void uart_exit(void);
void uart_send(void);

#endif
```

## src/app_button.c
```c
#include <zephyr.h>
#include <device.h>
#include <drivers/gpio.h>
#include <kernel.h>
#include <string.h>
#include <dk_buttons_and_leds.h>

#include "app_mqtt.h"
#include "app_button.h"

static bool led1_on = false;

#define MSG_1 "Pressed Button 1"
#define MSG_2 "Pressed Button 2"
#define MSG_3 "{\"health\":\"true\"}"
#define MSG_4 "{\"health\":\"false\"}"

// message queues
extern struct k_msgq button_msg_q;
extern struct k_msgq button_msg_qr;
static int app_button_config;

extern struct k_msgq uart_msg_q;
extern struct k_msgq mqtt_msg_q;


// LOCAL
const struct device *dev_button;


static void button_handler(uint32_t button_states, uint32_t has_changed)
{
	// printk("button states: %d, has changed: %d \n", button_states, has_changed);
	// printk("button 1: %d\n", gpio_pin_get(dev_button, 6));
	// printk("button 2: %d\n", gpio_pin_get(dev_button, 7));

	int app_button_ret_val;

	k_msgq_get(&button_msg_q, &app_button_config, K_NO_WAIT);

	// TODO: create functions for the cases
	switch (app_button_config)
	{
		case 0: // for waiting
			if(has_changed == 1 && !gpio_pin_get(dev_button, 6)) {
				app_button_ret_val = 1;
				k_msgq_put(&button_msg_qr, &app_button_ret_val, K_NO_WAIT);
			}
			break;

		case 1: // UART
			if(has_changed == 1 && !gpio_pin_get(dev_button, 6)) {
				k_msgq_put(&uart_msg_q, "{exit}", K_NO_WAIT);
			}
			break;

		case 2: // MQTT
			if(has_changed == 1 && !gpio_pin_get(dev_button, 6)) {
				k_msgq_put(&mqtt_msg_q, "exit", K_NO_WAIT);
			}

			else if(has_changed == 2 && !gpio_pin_get(dev_button, 7)) {
				app_data_publish(MSG_2, sizeof(MSG_2));
			}

			else if(has_changed == 4) {
				app_data_publish(MSG_3, sizeof(MSG_3));
			}

			else if(has_changed == 8) {
				app_data_publish(MSG_4, sizeof(MSG_4));
			}
			break;
		
		case 999: // DO NOT USE, ONLY FOR TEMPLATE
			if(has_changed == 1 && !gpio_pin_get(dev_button, 6)) {
				// empty
			}

			else if(has_changed == 2 && !gpio_pin_get(dev_button, 7)) {
				// empty
			}

			else if(has_changed == 4) {
				// empty
			}

			else if(has_changed == 8) {
				// empty
			}
			break;

		default:
			printk("\nunregistered button configuration\n");
			break;
	}

}

// initialize buttons
void button_dev_init(void) 
{
	dev_button = device_get_binding("GPIO_0");
	dk_buttons_init(button_handler);
}

// toggle specified led
int toggle_LED(int led_val)
{
	switch (led_val)
	{
		case 1:
			led1_on = !led1_on;
			dk_set_led(DK_LED1, led1_on);
			break;

		default:
			printk("\nunknown led value\n");
			break;
	}

	return 0;
}
```

## src/app_mqtt.c
```c
/*
 * Copyright (c) 2018 Nordic Semiconductor ASA
 *
 * SPDX-License-Identifier: LicenseRef-BSD-5-Clause-Nordic
 */

#include <zephyr.h>
#include <stdio.h>
#include <random/rand32.h>
#include <net/mqtt.h>
#include <net/socket.h>
#include <modem/lte_lc.h>
#include <logging/log.h>
#include <string.h>
#include "app_mqtt.h"
#include "app_button.h"


#if defined(CONFIG_MODEM_KEY_MGMT)
#include <modem/modem_key_mgmt.h>
#endif

// VARIABLES FROM MAIN
extern struct k_msgq mqtt_msg_q;


// LOCAL

int data_choice = 0;

LOG_MODULE_REGISTER(mqtt_simple, CONFIG_MQTT_SIMPLE_LOG_LEVEL);

/* Buffers for MQTT client. */
static uint8_t rx_buffer[CONFIG_MQTT_MESSAGE_BUFFER_SIZE];
static uint8_t tx_buffer[CONFIG_MQTT_MESSAGE_BUFFER_SIZE];
static uint8_t payload_buf[CONFIG_MQTT_PAYLOAD_BUFFER_SIZE];

/* The mqtt client struct */
static struct mqtt_client client;

/* MQTT Broker details. */
static struct sockaddr_storage broker;

/* File descriptor */
static struct pollfd fds;


#if defined(CONFIG_BSD_LIBRARY)

/**@brief Recoverable BSD library error. */
void bsd_recoverable_error_handler(uint32_t err)
{
	LOG_ERR("bsdlib recoverable error: %u", (unsigned int)err);
}

#endif /* defined(CONFIG_BSD_LIBRARY) */

/**@brief Function to print strings without null-termination
 */
static void data_print(uint8_t *prefix, uint8_t *data, size_t len)
{
	char buf[len + 1];

	memcpy(buf, data, len);
	buf[len] = 0;
	LOG_INF("%s%s", log_strdup(prefix), log_strdup(buf));
}

/**@brief Function to publish data on the configured topic
 */
int data_publish(struct mqtt_client *c, enum mqtt_qos qos,
	uint8_t *data, size_t len)
{
	struct mqtt_publish_param param;

	param.message.topic.qos = qos;
	param.message.topic.topic.utf8 = CONFIG_MQTT_PUB_TOPIC;
	param.message.topic.topic.size = strlen(CONFIG_MQTT_PUB_TOPIC);
	param.message.payload.data = data;
	param.message.payload.len = len;
	param.message_id = sys_rand32_get();
	param.dup_flag = 0;
	param.retain_flag = 0;

	data_print("Publishing: ", data, len);
	LOG_INF("to topic: %s len: %u",
		CONFIG_MQTT_PUB_TOPIC,
		(unsigned int)strlen(CONFIG_MQTT_PUB_TOPIC));

	return mqtt_publish(c, &param);
}

/**@brief Function to subscribe to the configured topic
 */
static int subscribe(void)
{
	struct mqtt_topic subscribe_topic = {
		.topic = {
			.utf8 = CONFIG_MQTT_SUB_TOPIC,
			.size = strlen(CONFIG_MQTT_SUB_TOPIC)
		},
		.qos = MQTT_QOS_1_AT_LEAST_ONCE
	};

	const struct mqtt_subscription_list subscription_list = {
		.list = &subscribe_topic,
		.list_count = 1,
		.message_id = 1234
	};

	LOG_INF("Subscribing to: %s len %u", CONFIG_MQTT_SUB_TOPIC,
		(unsigned int)strlen(CONFIG_MQTT_SUB_TOPIC));

	return mqtt_subscribe(&client, &subscription_list);
}

/**@brief Function to read the published payload.
 */
static int publish_get_payload(struct mqtt_client *c, size_t length)
{
	if (length > sizeof(payload_buf)) {
		return -EMSGSIZE;
	}

	return mqtt_readall_publish_payload(c, payload_buf, length);
}

/**@brief MQTT client event handler
 */
void mqtt_evt_handler(struct mqtt_client *const c,
		      const struct mqtt_evt *evt)
{
	int err;

	switch (evt->type) {
	case MQTT_EVT_CONNACK:
		if (evt->result != 0) {
			LOG_ERR("MQTT connect failed: %d", evt->result);
			break;
		}

		LOG_INF("MQTT client connected");
		subscribe();
		break;

	case MQTT_EVT_DISCONNECT:
		LOG_INF("MQTT client disconnected: %d", evt->result);
		break;

	case MQTT_EVT_PUBLISH: {
		const struct mqtt_publish_param *p = &evt->param.publish;

		LOG_INF("MQTT PUBLISH result=%d len=%d",
			evt->result, p->message.payload.len);
		err = publish_get_payload(c, p->message.payload.len);

		if (p->message.topic.qos == MQTT_QOS_1_AT_LEAST_ONCE) {
			const struct mqtt_puback_param ack = {
				.message_id = p->message_id
			};

			/* Send acknowledgment. */
			mqtt_publish_qos1_ack(&client, &ack);
		}

		if (err >= 0) {
			data_print("Received: ", payload_buf,
				p->message.payload.len);

			// fixing length of string to be added to message queue
			char tmp_str[p->message.payload.len + 1];
			memcpy(tmp_str, payload_buf, p->message.payload.len);
			tmp_str[p->message.payload.len] = 0;

			k_msgq_put(&mqtt_msg_q, tmp_str, K_NO_WAIT);
	
		} else {
			LOG_ERR("publish_get_payload failed: %d", err);
			LOG_INF("Disconnecting MQTT client...");

			err = mqtt_disconnect(c);
			if (err) {
				LOG_ERR("Could not disconnect: %d", err);
			}
		}
	} break;

	case MQTT_EVT_PUBACK:
		if (evt->result != 0) {
			LOG_ERR("MQTT PUBACK error: %d", evt->result);
			break;
		}

		LOG_INF("PUBACK packet id: %u", evt->param.puback.message_id);
		break;

	case MQTT_EVT_SUBACK:
		if (evt->result != 0) {
			LOG_ERR("MQTT SUBACK error: %d", evt->result);
			break;
		}

		LOG_INF("SUBACK packet id: %u", evt->param.suback.message_id);
		break;

	case MQTT_EVT_PINGRESP:
		if (evt->result != 0) {
			LOG_ERR("MQTT PINGRESP error: %d", evt->result);
		}
		break;

	default:
		LOG_INF("Unhandled MQTT event type: %d", evt->type);
		break;
	}
}

/**@brief Resolves the configured hostname and
 * initializes the MQTT broker structure
 */
static int broker_init(void)
{
	int err;
	struct addrinfo *result;
	struct addrinfo *addr;
	struct addrinfo hints = {
		.ai_family = AF_INET,
		.ai_socktype = SOCK_STREAM
	};

	err = getaddrinfo(CONFIG_MQTT_BROKER_HOSTNAME, NULL, &hints, &result);
	if (err) {
		LOG_ERR("getaddrinfo failed: %d", err);
		return -ECHILD;
	}

	addr = result;

	/* Look for address of the broker. */
	while (addr != NULL) {
		/* IPv4 Address. */
		if (addr->ai_addrlen == sizeof(struct sockaddr_in)) {
			struct sockaddr_in *broker4 =
				((struct sockaddr_in *)&broker);
			char ipv4_addr[NET_IPV4_ADDR_LEN];

			broker4->sin_addr.s_addr =
				((struct sockaddr_in *)addr->ai_addr)
				->sin_addr.s_addr;
			broker4->sin_family = AF_INET;
			broker4->sin_port = htons(CONFIG_MQTT_BROKER_PORT);

			inet_ntop(AF_INET, &broker4->sin_addr.s_addr,
				  ipv4_addr, sizeof(ipv4_addr));
			LOG_INF("IPv4 Address found %s", log_strdup(ipv4_addr));

			break;
		} else {
			LOG_ERR("ai_addrlen = %u should be %u or %u",
				(unsigned int)addr->ai_addrlen,
				(unsigned int)sizeof(struct sockaddr_in),
				(unsigned int)sizeof(struct sockaddr_in6));
		}

		addr = addr->ai_next;
	}

	/* Free the address. */
	freeaddrinfo(result);

	return err;
}

/**@brief Initialize the MQTT client structure
 */
static int client_init(struct mqtt_client *client)
{
	int err;

	mqtt_client_init(client);

	err = broker_init();
	if (err) {
		LOG_ERR("Failed to initialize broker connection");
		return err;
	}
	
	/* MQTT client configuration */
	client->broker = &broker;
	client->evt_cb = mqtt_evt_handler;
	client->client_id.utf8 = (uint8_t *)CONFIG_MQTT_CLIENT_ID;
	client->client_id.size = strlen(CONFIG_MQTT_CLIENT_ID);
	client->password = NULL;
	client->user_name = NULL;
	client->protocol_version = MQTT_VERSION_3_1_1;

	/* MQTT buffers configuration */
	client->rx_buf = rx_buffer;
	client->rx_buf_size = sizeof(rx_buffer);
	client->tx_buf = tx_buffer;
	client->tx_buf_size = sizeof(tx_buffer);

	/* MQTT transport configuration */
#if defined(CONFIG_MQTT_LIB_TLS)
	struct mqtt_sec_config *tls_cfg = &(client->transport).tls.config;
	static sec_tag_t sec_tag_list[] = { CONFIG_MQTT_TLS_SEC_TAG };

	LOG_INF("TLS enabled");
	client->transport.type = MQTT_TRANSPORT_SECURE;

	tls_cfg->peer_verify = CONFIG_MQTT_TLS_PEER_VERIFY;
	tls_cfg->cipher_count = 0;
	tls_cfg->cipher_list = NULL;
	tls_cfg->sec_tag_count = ARRAY_SIZE(sec_tag_list);
	tls_cfg->sec_tag_list = sec_tag_list;
	tls_cfg->hostname = CONFIG_MQTT_BROKER_HOSTNAME;

#if defined(CONFIG_BSD_LIBRARY)
	tls_cfg->session_cache = IS_ENABLED(CONFIG_MQTT_TLS_SESSION_CACHING) ?
					    TLS_SESSION_CACHE_ENABLED :
					    TLS_SESSION_CACHE_DISABLED;
#else
	/* TLS session caching is not supported by the Zephyr network stack */
	tls_cfg->session_cache = TLS_SESSION_CACHE_DISABLED;

#endif

#else
	client->transport.type = MQTT_TRANSPORT_NON_SECURE;
#endif

	return err;
}

/**@brief Initialize the file descriptor structure used by poll.
 */
static int fds_init(struct mqtt_client *c)
{
	if (c->transport.type == MQTT_TRANSPORT_NON_SECURE) {
		fds.fd = c->transport.tcp.sock;
	} else {
	#if defined(CONFIG_MQTT_LIB_TLS)
		fds.fd = c->transport.tls.sock;
	#else
		return -ENOTSUP;
	#endif
	}

	fds.events = POLLIN;

	return 0;
}

/**@brief Configures modem to provide LTE link. Blocks until link is
 * successfully established.
 */
static int modem_configure(void)
{
	int err;

	LOG_INF("LTE Link Connecting and Initializing...");
	err = lte_lc_init_and_connect();
	if (err) {
		LOG_INF("Failed to establish LTE connection: %d", err);
		return err;
	}
	LOG_INF("LTE Link Connected!");

	/* Turn off power saving modes for a more responsive demo */
	LOG_INF("Disabling PSM and eDRX");
	lte_lc_psm_req(false);
	lte_lc_edrx_req(false);

	return err;
}

// CUSTOM FUNCTIONS START

static int modem_reconnect(void)
{
	int err;

	LOG_INF("LTE Link Connecting...");
	err = lte_lc_connect();
	if (err) {
		LOG_INF("Failed to establish LTE connection: %d", err);
		return err;
	}

	LOG_INF("LTE Link Connected!");

	return err;
}

// TODO: set max number of retries
int app_mqtt_init_and_connect(void)
{
	int err = 0;

	// modem configure
	do {
		err = modem_configure();
		if (err) {
			LOG_INF("Retrying in %d seconds", CONFIG_LTE_CONNECT_RETRY_DELAY_S);
			k_sleep(K_SECONDS(CONFIG_LTE_CONNECT_RETRY_DELAY_S));
		}
		} while (err);

	// mqtt init
	err = client_init(&client);
	if (err != 0) {
		LOG_ERR("client_init: %d", err);
		return err;
	}

	// mqtt connect
	do {
		err = mqtt_connect(&client);
		if (err != 0) {
			LOG_ERR("mqtt_connect %d", err);
			LOG_INF("Reconnecting in %d seconds...", CONFIG_MQTT_RECONNECT_DELAY_S);
			k_sleep(K_SECONDS(CONFIG_MQTT_RECONNECT_DELAY_S));
		}
	} while (err);

	// fds init
	err = fds_init(&client);
	if (err != 0) {
		LOG_ERR("fds_init: %d", err);
		return err;
	}

	return err;
}

// TODO: set max number of retries
int app_mqtt_connect(void)
{
    int err = 0;

	// modem configure
	do {
		err = modem_reconnect();
		if (err) {
			LOG_INF("Retrying in %d seconds", CONFIG_LTE_CONNECT_RETRY_DELAY_S);
			k_sleep(K_SECONDS(CONFIG_LTE_CONNECT_RETRY_DELAY_S));
		}
	} while (err);

	// mqtt connect
	do {
		err = mqtt_connect(&client);
		if (err != 0) {
			LOG_ERR("mqtt_connect %d", err);
			LOG_INF("Reconnecting in %d seconds...", CONFIG_MQTT_RECONNECT_DELAY_S);
			k_sleep(K_SECONDS(CONFIG_MQTT_RECONNECT_DELAY_S));
		}
	} while (err);

	return err;
}

// CANDO: change poll to message queueing to allow instantaneous response from button
int app_mqtt_run(void)
{	
	int err;

	err = poll(&fds, 1, mqtt_keepalive_time_left(&client));
	if (err < 0) {
		LOG_ERR("poll: %d", errno);
		return err;
	}

	err = mqtt_live(&client);
	if ((err != 0) && (err != -EAGAIN)) {
		LOG_ERR("ERROR: mqtt_live: %d", err);
		return err;
	}

	if ((fds.revents & POLLIN) == POLLIN) {
		err = mqtt_input(&client);
		if (err != 0) {
			LOG_ERR("mqtt_input: %d", err);
			return err;
		}
	}

	if ((fds.revents & POLLERR) == POLLERR) {
		LOG_ERR("POLLERR");
		return err;
	}

	if ((fds.revents & POLLNVAL) == POLLNVAL) {
		LOG_ERR("POLLNVAL");
		return err;
	}

	return err;
}

int app_mqtt_disconnect(void)
{
    int err;
    
	LOG_INF("Disconnecting MQTT client...");

	err = mqtt_disconnect(&client);
	if (err) {
		LOG_ERR("Could not disconnect MQTT client: %d", err);
		return err;
	}

	err = lte_lc_offline();
	if (err) {
		LOG_ERR("Could not set modem to offline: %d", err);
	}
	
	return err;
}

int app_data_publish(uint8_t *data, size_t len) {

	int err;
	err = data_publish(&client, MQTT_QOS_1_AT_LEAST_ONCE, data, len-1);

	if (err) {
		LOG_ERR("Publish failed: %d", err);
	}

	return err;
}
```

## src/app_uart.c
```c
#include <zephyr.h>
#include <drivers/uart.h>
#include <string.h>
#include "app_uart.h"

// VARIABLES FROM MAIN
extern struct k_msgq uart_msg_q;

// LOCAL
uint8_t str_buf[128];

const struct device *dev_uart;
static uint8_t buf[] = {"hi,"};

static void uart_cb(const struct device *dev_uart, void *context)
{

	uart_irq_update(dev_uart);

	if (uart_irq_tx_ready(dev_uart)) {
		(void)uart_fifo_fill(dev_uart, buf, sizeof(buf));
		uart_irq_tx_disable(dev_uart);
		printk("sent\n");
	}

	if (uart_irq_rx_ready(dev_uart)) {
		uint8_t buf[10];
		int len = uart_fifo_read(dev_uart, buf, sizeof(buf));
		buf[len] = 0;

		if (strcmp(buf, "{") == 0)
		{
			strcpy(str_buf, "");
			strcat(str_buf, buf);
		}
		else if (strcmp(buf, "}") == 0)
		{
			strcat(str_buf, buf);
			k_msgq_put(&uart_msg_q, &str_buf, K_NO_WAIT);
		}
		else
		{
			strcat(str_buf, buf);
		}

	}
}

// get device binding, only call once
void uart_dev_init(void)
{
	dev_uart = device_get_binding("UART_1");
	__ASSERT(dev_uart, "Failed to get the device\n\n");

	uart_irq_callback_set(dev_uart, uart_cb);

}

// start uart, run before using uart functions,
// add more here if other functions need to be enabled before uart use
void uart_start(void)
{
	uart_irq_rx_disable(dev_uart);
	uart_irq_rx_enable(dev_uart);
}

// turn off functions, might have to come back here and more things to disable
void uart_exit(void)
{
	uart_irq_rx_disable(dev_uart);
}

// send data to uart device
// TODO: add parameters to choose data to be sent, currently only sends "hi"
// should be useable in main
void uart_send(void)
{
	uart_irq_tx_enable(dev_uart);
}

/* Function ideas and TODOs

buffer read until a delimiter, save to array and start saving to array+1
- May not be the best idea to implement here, probably better to create this function in main
  to avoid creating too many variables that overlap.

- Overhaul saving of data. Ideal: just send buffer to main (e.g. mailbox), let main append data
  and split into array.

- Add timestamp to when the data was received.

*/
```
