## Kconfig
```
# Private config options for Google Cloud IOT application

# Copyright (c) 2018 Linaro
# SPDX-License-Identifier: Apache-2.0

mainmenu "Google IOT MQTT/TLS sample application"

config LTE_CONNECT_RETRY_DELAY_S
	int "Seconds to delay before attempting to retry LTE connection"
	default 120


config CLOUD_CLIENT_ID
	string "Client ID string"
	default "put client string here"
	help
	  Set required client string that matches Google Cloud project

config CLOUD_AUDIENCE
	string "Audience string"
	default "put audience string here"
	help
	  Set required audience string that matches Google Cloud project

config CLOUD_SUBSCRIBE_CONFIG
	string "Subscription string for config"
	default "put subscription string here"
	help
	  Set required subscription string that matches Google Cloud project
	  config item.

config CLOUD_PUBLISH_TOPIC
	string "Publish topic string"
	default "put topic string here"
	help
	  Set publish topics string that matches Google Cloud project

source "Kconfig.zephyr"
```

## prj.conf
```kconfig
CONFIG_NETWORKING=y
CONFIG_NET_IPV6=n
CONFIG_NET_IPV4=y
CONFIG_NET_UDP=y
CONFIG_NET_TCP=y
CONFIG_NET_DHCPV4=y
CONFIG_STDOUT_CONSOLE=y

CONFIG_NET_PKT_RX_COUNT=4
CONFIG_NET_PKT_TX_COUNT=4
CONFIG_NET_BUF_RX_COUNT=12
CONFIG_NET_BUF_TX_COUNT=12

CONFIG_INIT_STACKS=y

CONFIG_JWT=y
CONFIG_JWT_SIGN_ECDSA=y

CONFIG_NET_MGMT=y
CONFIG_NET_MGMT_EVENT=y

CONFIG_LOG=y

# This shouldn't need to be set, but isn't selected properly.
CONFIG_NEWLIB_LIBC=y

CONFIG_DNS_SERVER_IP_ADDRESSES=y
CONFIG_DNS_SERVER1="8.8.8.8"

CONFIG_DNS_RESOLVER=y
CONFIG_DNS_RESOLVER_ADDITIONAL_BUF_CTR=2
CONFIG_SNTP=y

CONFIG_SLIP_STATISTICS=n

CONFIG_HW_STACK_PROTECTION=y
CONFIG_MAIN_STACK_SIZE=4096

CONFIG_MBEDTLS_SSL_MAX_CONTENT_LEN=16384

CONFIG_DEBUG_OPTIMIZATIONS=y

CONFIG_PTHREAD_IPC=n
CONFIG_NET_SOCKETS=y
CONFIG_MQTT_LIB=y
CONFIG_MQTT_LIB_TLS=y
CONFIG_MQTT_CLEAN_SESSION=y
CONFIG_NET_SOCKETS_SOCKOPT_TLS=y


# Enable MBEDTLS
CONFIG_MBEDTLS=y
CONFIG_MBEDTLS_BUILTIN=y
CONFIG_AT_HOST_LIBRARY=y
CONFIG_NET_SOCKETS_POSIX_NAMES=y

CONFIG_MBEDTLS_ENABLE_HEAP=y
CONFIG_MBEDTLS_HEAP_SIZE=56240
CONFIG_MBEDTLS_USER_CONFIG_ENABLE=y
CONFIG_MBEDTLS_USER_CONFIG_FILE="user-tls.conf"


# BSD library
CONFIG_BSD_LIBRARY=y
# LTE link control
CONFIG_LTE_LINK_CONTROL=y
CONFIG_LTE_AUTO_INIT_AND_CONNECT=n


# Please see README.rst in this directory for instructions
# on where to get the values for these config entries.
# PROJECT_ID: NordicOasys
# REGION: europe-west1
# REGISTRY_ID: OasysFleet
# DEVICE_ID: nrf9160dk

CONFIG_CLOUD_CLIENT_ID="projects/NordicOasys/locations/europe-west1/registries/OasysFleet/devices/nrf9160dk"
CONFIG_CLOUD_AUDIENCE="NordicOasys"
CONFIG_CLOUD_SUBSCRIBE_CONFIG="/devices/nrf9160dk/config"
CONFIG_CLOUD_PUBLISH_TOPIC="/devices/nrf9160dk/state"
```

## src/main.c
```c
/* Full-stack IoT client example. */

/*
 * Copyright (c) 2018 Linaro Ltd
 *
 * SPDX-License-Identifier: Apache-2.0
 */

#include <zephyr.h>

#include "dhcp.h"
#include "protocol.h"

#include <net/sntp.h>
#include <net/net_config.h>
#include <net/net_event.h>


#include <net/mqtt.h>
#include <net/socket.h>
#include <modem/lte_lc.h>

#define LOG_LEVEL CONFIG_LOG_DEFAULT_LEVEL
#include <logging/log.h>

LOG_MODULE_REGISTER(net_google_iot_mqtt, LOG_LEVEL_INF);

/* This comes from newlib. */
#include <time.h>
#include <inttypes.h>

int64_t time_base;

int do_sntp(void)
{
	int rc;
	struct sntp_time sntp_time;
	char time_str[sizeof("1970-01-01T00:00:00")];

	LOG_INF("Sending NTP request for current time:");

	rc = sntp_simple("time.google.com", SYS_FOREVER_MS, &sntp_time);
	if (rc == 0) {
		time_base = sntp_time.seconds * MSEC_PER_SEC - k_uptime_get();

		/* Convert time to make sure. */
		time_t now = sntp_time.seconds;
		struct tm now_tm;

		gmtime_r(&now, &now_tm);
		strftime(time_str, sizeof(time_str), "%FT%T", &now_tm);
		LOG_INF("  Acquired time: %s", log_strdup(time_str));

	} else {
		LOG_ERR("  Failed to acquire SNTP, code %d\n", rc);
	}
	return rc;
}


/**@brief Configures modem to provide LTE link. Blocks until link is
 * successfully established.
 */
static int modem_configure(void)
{
	int err;

	printk("LTE Link Connecting and Initializing...");
	err = lte_lc_init_and_connect();
	if (err) {
		printk("Failed to establish LTE connection: %d", err);
		return err;
	}
	printk("LTE Link Connected!");

	/* Turn off power saving modes for a more responsive demo */
	printk("Disabling PSM and eDRX");
	lte_lc_psm_req(false);
	lte_lc_edrx_req(false);

	return err;
}

/* 
 * Initiates 4G connection
 */
int start_4G_LTE() {
	int err = 0;
	// modem configure
	do {
		err = modem_configure();
		if (err) {
			printk("Retrying in %d seconds", CONFIG_LTE_CONNECT_RETRY_DELAY_S);
			k_sleep(K_SECONDS(CONFIG_LTE_CONNECT_RETRY_DELAY_S));
		}
	} while (err);

	return err;
}


/*
 * Things that make sense in a demo app that would need to be more
 * robust in a real application:
 *
 * - DHCP happens once.  If it fails, or we change networks, the
 *   network will just stop working.
 *
 */
void main(void)
{
	LOG_INF("Main entered");

	// start_4G_LTE();
	int err = 0;
	// modem configure
	do {
		err = modem_configure();
		if (err) {
			printk("Retrying in %d seconds", CONFIG_LTE_CONNECT_RETRY_DELAY_S);
			k_sleep(K_SECONDS(CONFIG_LTE_CONNECT_RETRY_DELAY_S));
		}
	} while (err);


	// app_dhcpv4_startup();

	LOG_INF("Should have DHCPv4 lease at this point.");

	/* early return if we failed to acquire time */
	if (do_sntp() != 0) {
		LOG_ERR("Failed to get NTP time");
		return;
	}

	mqtt_startup("mqtt.googleapis.com", 8883);
}
```
