## CMakeLists.txt
```
#
# Copyright (c) 2018 Nordic Semiconductor ASA
#
# SPDX-License-Identifier: LicenseRef-BSD-5-Clause-Nordic
#

cmake_minimum_required(VERSION 3.13.1)

find_package(Zephyr REQUIRED HINTS $ENV{ZEPHYR_BASE})
project(mqtt-simple)

# NORDIC SDK APP START

target_sources(app PRIVATE
    src/main.c
    src/app_button.c
    src/app_mqtt.c

    
    include/app_button.h
    include/app_mqtt.h)

zephyr_include_directories(include)

# NORDIC SDK APP END
```

## prj.conf
```kconfig
#
# Copyright (c) 2020 Nordic Semiconductor ASA
#
# SPDX-License-Identifier: LicenseRef-BSD-5-Clause-Nordic
#

# Networking
CONFIG_NETWORKING=y
CONFIG_NET_NATIVE=n
CONFIG_NET_SOCKETS_OFFLOAD=y
CONFIG_NET_SOCKETS=y
CONFIG_NET_SOCKETS_POSIX_NAMES=y

# LTE link control
CONFIG_LTE_LINK_CONTROL=y
CONFIG_LTE_AUTO_INIT_AND_CONNECT=n

# BSD library
CONFIG_BSD_LIBRARY=y

# AT Host
CONFIG_UART_INTERRUPT_DRIVEN=y
CONFIG_AT_HOST_LIBRARY=y

# MQTT
CONFIG_MQTT_LIB=y
CONFIG_MQTT_LIB_TLS=n
CONFIG_MQTT_CLEAN_SESSION=y

# Application
CONFIG_MQTT_PUB_TOPIC="einarNordicnrf9160"
CONFIG_MQTT_SUB_TOPIC="einarNordicnrf9160_2"
CONFIG_MQTT_CLIENT_ID="einarNrf9160"
CONFIG_MQTT_BROKER_HOSTNAME="broker.mqttdashboard.com"
CONFIG_MQTT_BROKER_PORT=1883

# Button support
CONFIG_DK_LIBRARY=y

# Enable logging
CONFIG_LOG=y
CONFIG_MQTT_SIMPLE_LOG_LEVEL_DBG=y

# Memory
CONFIG_MAIN_STACK_SIZE=4096
CONFIG_HEAP_MEM_POOL_SIZE=2048

CONFIG_BUTTON_EVENT_BTN_NUM=1
CONFIG_BUTTON_EVENT_PUBLISH_MSG="test message"

CONFIG_DK_LIBRARY_INVERT_LEDS=n
# CONFIG_DK_LIBRARY_INVERT_BUTTONS=n
```

## include/app_mqtt.h
```c
#pragma once
#ifndef _APP_MQTT_H_
#define _APP_MQTT_H_


int modem_configure(void);

int app_data_publish(uint8_t *data, size_t len);

int app_mqtt_init(void);

int app_mqtt_run(void);

int app_mqtt_disconnect(void);

#endif
```

## src/app_button.c
```c
#include <zephyr.h>
#include <device.h>
#include <drivers/gpio.h>
#include <string.h>
#include <dk_buttons_and_leds.h>
#include "app_mqtt.h"
#include "app_button.h"

bool ledOn = 0;

#define MSG_1 "Pressed Button 1"
#define MSG_2 "Pressed Button 2"
#define MSG_3 "Changed Switch 1"
#define MSG_4 "Changed Switch 2"

const struct device *dev;

void button_dev_init(void) {
	dev = device_get_binding("GPIO_0");
}


void button_handler(uint32_t button_states, uint32_t has_changed)
{
	printk("button states: %d, has changed: %d \n", button_states, has_changed);
	printk("button 1: %d\n", gpio_pin_get(dev, 6));
	printk("button 2: %d\n", gpio_pin_get(dev, 7));

	if((has_changed == 1) && (!gpio_pin_get(dev, 6)))
	{
		app_data_publish(MSG_1, sizeof(MSG_1));
	}
	else if(has_changed == 2 && !gpio_pin_get(dev, 7))
	{
		app_data_publish(MSG_2, sizeof(MSG_2));
	}
	else if(has_changed == 4)
	{
		app_data_publish(MSG_3, sizeof(MSG_3));
	}
	else if(has_changed == 8)
	{
		app_data_publish(MSG_4, sizeof(MSG_4));
	}


}


void toggleLED(uint8_t *data, size_t len) {
    if(strcmp(data, "LED") == 0) {
            ledOn = !ledOn;
            dk_set_led(DK_LED1, ledOn);
    }
}
```
