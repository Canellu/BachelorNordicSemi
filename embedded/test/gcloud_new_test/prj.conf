## CMakeLists.txt
```
#
# Copyright (c) 2019 Nordic Semiconductor
#
# SPDX-License-Identifier: LicenseRef-BSD-5-Clause-Nordic
#

cmake_minimum_required(VERSION 3.8.2)

set(BOARD nrf9160_pca10090ns)

# This sample runs as a non-secure application on nRF91. Therefore, it
# requires the secure_partition_manager that prepares the required
# peripherals to be available for the application.
#
# Configure the SPM image to enable the peripherals that this sample
# needs.

include($ENV{ZEPHYR_BASE}/cmake/app/boilerplate.cmake NO_POLICY_SCOPE)
# find_package(Zephyr REQUIRED HINTS $ENV{ZEPHYR_BASE})
project(NONE)

if(NOT EXISTS ${APPLICATION_SOURCE_DIR}/src/private_info/key.c)
    message(FATAL_ERROR "!!!!!! Generate key file before continuing !!!!!!")
endif()


# NORDIC SDK APP START
target_sources(app PRIVATE
    src/main.c
    src/cJSON.c
    src/gcloud.c
    src/ntp.c

    
    include/cJSON.h
    include/gcloud.h
    include/gcloud_defines.h
    include/ntp.h
    )
# NORDIC SDK APP END

# Include application events and configuration headers
zephyr_include_directories(include)

# Application sources
target_sources(app PRIVATE ${APPLICATION_SOURCE_DIR}/src/private_info/key.c)
```

## Kconfig
```
#
# Copyright (c) 2019 Nordic Semiconductor ASA
#
# SPDX-License-Identifier: LicenseRef-BSD-5-Clause-Nordic
#

menu "Google Cloud"

config GCLOUD_PROJECT_NAME
    string "Name of the Google Cloud project"

config GCLOUD_REGION
    string "Google cloud region"

config GCLOUD_REGISTRY_NAME
    string "Name of the Google Cloud reigstry of the device"

config GCLOUD_DEVICE_NAME
    string "Name of the device in Google Cloud"

endmenu # Google Cloud

menu "Cloud"

config MQTT_KEEPALIVE
	int "MQTT keepalive timer"
	default 120

config CLOUD_WAIT_DURATION
	int "Cloud connection acknowledge wait duration"
	default 30
	help
	    How long the device should wait for a CONNACK
	    event from the cloud.

endmenu # Cloud

menu "AT Commands"

config USE_AT_HOST
	bool "Enable AT commands"
	default y
	select AT_HOST_LIBRARY
	help
		Enable the AT host library so that AT commands can be sent to and
		received from a serial terminal.

endmenu #Enable AT commands

menu "MQTT"

config MQTT_MESSAGE_BUFFER_SIZE
    int "MQTT message buffer size"
    default 256

endmenu

menu "Zephyr Kernel"
source "$ZEPHYR_BASE/Kconfig.zephyr"
endmenu #Zephyr Kernel
```

## prj.conf
```kconfig
# General config
CONFIG_NEWLIB_LIBC=y
CONFIG_NEWLIB_LIBC_FLOAT_PRINTF=y
CONFIG_SERIAL=y
CONFIG_TEST_RANDOM_GENERATOR=y
# CONFIG_ASSERT=y
CONFIG_LOG=y
CONFIG_LOG_BACKEND_SHOW_COLOR=n
CONFIG_TRUSTED_EXECUTION_NONSECURE=y
CONFIG_DEPRECATED_ZEPHYR_INT_TYPES=y

# Network
CONFIG_NETWORKING=y
CONFIG_NET_NATIVE=n
CONFIG_NET_SOCKETS_OFFLOAD=y
CONFIG_NET_SOCKETS=y
CONFIG_NET_SOCKETS_POSIX_NAMES=y

# MQTT
CONFIG_MQTT_LIB=y
CONFIG_MQTT_LIB_TLS=n
CONFIG_MQTT_CLEAN_SESSION=y
CONFIG_MODEM_KEY_MGMT=y

# LTE link control
CONFIG_LTE_LINK_CONTROL=y
CONFIG_LTE_AUTO_INIT_AND_CONNECT=n
CONFIG_LTE_LINK_CONTROL_LOG_LEVEL_DBG=n
CONFIG_LTE_NETWORK_MODE_NBIOT=n 
CONFIG_LTE_LEGACY_PCO_MODE=n 
CONFIG_LTE_PSM_REQ_RPTAU="00000110"
CONFIG_LTE_PSM_REQ_RAT="00000000"

# AT host
CONFIG_AT_HOST_LIBRARY=y

# BSD library
CONFIG_BSD_LIBRARY=y
CONFIG_BSD_LIBRARY_TRACE_ENABLED=n

# Library for buttons and LEDs
CONFIG_DK_LIBRARY=y 
CONFIG_DK_LIBRARY_INVERT_LEDS=n 

# Console
CONFIG_CONSOLE_SUBSYS=y
CONFIG_CONSOLE_GETCHAR=y

CONFIG_CONSOLE=y
CONFIG_UART_CONSOLE=y

# Main thread
CONFIG_MAIN_THREAD_PRIORITY=7

#HCI
CONFIG_UART_INTERRUPT_DRIVEN=y

# Heap and stacks
CONFIG_HEAP_MEM_POOL_SIZE=16384
CONFIG_MAIN_STACK_SIZE=8192
CONFIG_SYSTEM_WORKQUEUE_STACK_SIZE=2048

# JWT
CONFIG_JWT=y
CONFIG_JWT_SIGN_ECDSA=y

# Google Cloud
CONFIG_GCLOUD_REGION="europe-west1"
CONFIG_GCLOUD_PROJECT_NAME="nordicoasys"
CONFIG_GCLOUD_REGISTRY_NAME="OasysFleet"
CONFIG_GCLOUD_DEVICE_NAME="nrf9160dk"
```

## src/main.c
```c
/*
 * Copyright (c) 2019 Nordic Semiconductor ASA
 *
 * SPDX-License-Identifier: LicenseRef-BSD-5-Clause-Nordic
 */

#include <zephyr.h>
#include <kernel_structs.h>
#include <stdio.h>
#include <string.h>
#include <console/console.h>
#include <power/reboot.h>
#include <logging/log_ctrl.h>

#if defined(CONFIG_BSD_LIBRARY)
#include <bsd.h>
#include <modem/lte_lc.h>
#endif /* CONFIG_BSD_LIBRARY */
#include <net/socket.h>
#include <net/mqtt.h>

#include "cJSON.h"
#include "ntp.h"
#include "gcloud.h"

#define CALIBRATION_PRESS_DURATION K_SECONDS(5)
#define SLEEP_TIME 10010

#if defined(CONFIG_BSD_LIBRARY) && \
	!defined(CONFIG_LTE_LINK_CONTROL)
#error  "Missing CONFIG_LTE_LINK_CONTROL"
#endif

#define UNIQUE_PATH_ID_LENGTH 11

/* Global variables */
static char uniquePathID[UNIQUE_PATH_ID_LENGTH] = "00_0000000";

extern atomic_t connected;
extern atomic_t connecting;

enum error_type
{
	ERROR_CLOUD,
	ERROR_BSD_RECOVERABLE,
	ERROR_BSD_IRRECOVERABLE,
	ERROR_LTE_LC,
	ERROR_THREAD
};

/**@brief Configures modem to provide LTE link. Blocks until link is
 * successfully established.
 */
static int modem_configure(void)
{
#if defined(CONFIG_LTE_LINK_CONTROL)
	if (IS_ENABLED(CONFIG_LTE_AUTO_INIT_AND_CONNECT)) {
		/* Do nothing, modem is already turned on
		 * and connected.
		 */
	} else {
#if defined(CONFIG_LWM2M_CARRIER)
		/* Wait for the LWM2M_CARRIER to configure the modem and
		 * start the connection.
		 */
		printk("Waitng for carrier registration...\n");
		k_sem_take(&carrier_registered, K_FOREVER);
		printk("Registered!\n");
#else /* defined(CONFIG_LWM2M_CARRIER) */
		int err;

		printk("LTE Link Connecting...\n");
		err = lte_lc_init_and_connect();
		if (err) {
			printk("Failed to establish LTE connection: %d", err);
			return err;
		}
		printk("LTE Link Connected!\n");
#endif /* defined(CONFIG_LWM2M_CARRIER) */
	}
#endif /* defined(CONFIG_LTE_LINK_CONTROL) */

	/* Turn off power saving modes for a more responsive demo */
	printk("Disabling PSM and eDRX\n");
	lte_lc_psm_req(false);
	lte_lc_edrx_req(false);
	printk("disabling finished\n\n");

	return 0;
}

void main(void)
{
	int ret;

	printk("Program started\n");

	ret = gcloud_provision();
	if (ret)
	{
		printk("Failed to provision: %d\n", ret);
	}
	else
	{
		printk("Provisioning complete\n");
	}

	modem_configure();

    // k_timer_init(&reconnect_timer, reconnect_timer_handler, NULL);

    gcloud_connect();
    
    /* Waiting for client socket to be initialized */
    for (int i = 200;
         (!atomic_get(&connecting)) && (!atomic_get(&connected)) && (i > 0); i--)
    {
        k_sleep(K_MSEC(50));
    }

    struct pollfd fds[] = {
        {.fd = client.transport.tcp.sock,
         .events = POLLIN}};

	u32_t cnt = 0;

    while (true)
    {
        ret = poll(fds, ARRAY_SIZE(fds),
                   mqtt_keepalive_time_left(&client));

        if (ret < 0)
        {
            printk("poll() returned an error: %d", ret);
            continue;
        }

        if (ret == 0)
        {
            printk("GCLOUD: ping");
            gcloud_ping();
            continue;
        }

        if ((fds[0].revents & POLLIN) == POLLIN)
        {
            printk("GCLOUD: process");
            gcloud_process();
        }

        if ((fds[0].revents & POLLNVAL) == POLLNVAL)
        {
            printk("Socket error: POLLNVAL");
            return;
        }

        if ((fds[0].revents & POLLHUP) == POLLHUP)
        {
            printk("Socket error: POLLHUP");
            return;
        }

        if ((fds[0].revents & POLLERR) == POLLERR)
        {
            printk("Socket error: POLLERR");
            return;
        }

		double yrNum = 22021 - cnt;
        cJSON * yrObj = cJSON_CreateObject();
        cJSON * year = NULL;
        char * JSONString = NULL;
        year = cJSON_CreateNumber(yrNum);
        const char * yrStr = "Message";

        cJSON_AddItemToObject(yrObj, yrStr, year);
        JSONString = cJSON_Print(yrObj);
        cJSON_Delete(yrObj);

	    printk("Sending JSON data:\n%s\n", JSONString);
	    gcloud_publish(JSONString, strlen(JSONString), MQTT_QOS_1_AT_LEAST_ONCE);
		cnt++;
    }

	while (!gcloud_get_connection_status())
	{
		k_sleep(K_SECONDS(1));
	}

	u32_t cnt = 0;
	for(int i = 0; ; i++) {
        k_sleep(K_MSEC(SLEEP_TIME));

        double yrNum = 22021 - cnt;
        cJSON * yrObj = cJSON_CreateObject();
        cJSON * year = NULL;
        char * JSONString = NULL;
        year = cJSON_CreateNumber(yrNum);
        const char * yrStr = "Message";

        cJSON_AddItemToObject(yrObj, yrStr, year);
        JSONString = cJSON_Print(yrObj);
        cJSON_Delete(yrObj);

	    printk("Sending JSON data:\n%s\n", JSONString);
	    gcloud_publish(JSONString, strlen(JSONString), MQTT_QOS_1_AT_LEAST_ONCE);
	}
}
```

## include/gcloud.h
```c
/*
 * Copyright (c) 2019 Nordic Semiconductor ASA
 *
 * SPDX-License-Identifier: LicenseRef-BSD-5-Clause-Nordic
 */

#ifndef _GCLOUD_H_
#define _GCLOUD_H_

#include <net/mqtt.h>

/**
 * @brief Connects the device to Google Cloud, and subscribes to Google Cloud's configuration topic.
 * 
 * @note gcloud_provision must be called before this.
 * @note Shall be called before trying to send data to Google Cloud.
 * @note The modem must be turned on, and connected before this function can be called.
 */
void gcloud_connect(void);

/**
 * @brief Initializes the module and provisions the modem so that an TLS 
 * connection can be established to Google Cloud.
 * 
 * @note Shall be called before the modem is turned on.
 * @note Shall be called before gcloud_connect.
 * @note If module initialization fails, no module APIs shall be called.
 * 
 * @retval 0 or an error code indicating reason for failure.
 */
int gcloud_provision(void);

/**
 * @brief Disconnects the device from Google Cloud, then reboots.
 * 
 * @retval 0 or an error code indicating reason for failure.
 */
int gcloud_disconnect(bool RECONNECT);

/**
 * @brief Publishes device gps to Google Cloud.
 * 
 * @note Google Cloud only supports QoS 0 and QoS 1, not QoS 2
 * 
 * @param[in] data A pointer to the data to be sent.
 * @param[in] size The size of the data to be sent.
 * @param[in] qos The Quality of Serive level to be used when sending the
 *            telemetry.
 * 
 * @retval 0 or an error code indicating reason for failure.
 */
int gcloud_publish(u8_t *data, u32_t size, enum mqtt_qos qos);

/**
 * @brief Publishes device state to Google Cloud.
 * 
 * @note Google Cloud does only support QoS 0 and QoS 1, not Qos 2.
 * @note Google Cloud limits state updates to 1 update per second, per device. 
 *       However, for best results, device state should be updated much less often 
 *       - at most, once every 10 second.
 * 
 * @param[in] data A pointer to the data to be sent.
 * @param[in] size The size of the data to be sent.
 * @param[in] qos The Quality of service level to be used when sending the state.
 * 
 * @retval 0 or an error code indicating reson for failure.
 */
int gcloud_publish_state(u8_t *data, u32_t size, enum mqtt_qos qos);

void gcloud_process(void);
void gcloud_ping(void);


/**
 * @brief Returns current connection status.
 * 
 * @retval 0(disconnected) or 1(connected)
 */
int gcloud_get_connection_status();

/**
 * @brief Start the the gcloud thread.
 * 
 * @note The modem must be turned on, and connected before this function can be called.
 */
void gcloud_start_thread(void);

#endif /* _GCLOUD_H_ */
```

## include/gcloud_defines.h
```c
/*
 * Copyright (c) 2019 Nordic Semiconductor ASA
 *
 * SPDX-License-Identifier: LicenseRef-BSD-5-Clause-Nordic
 */

/**@file
 *
 * @brief   Defines for Google Cloud and MQTT
 */

#define ROOT_CERT                                                        \
    "-----BEGIN CERTIFICATE-----\n"                                      \
    "MIIBdTCCARugAwIBAgIJAOvj4PVfAgqjMAoGCCqGSM49BAMCMBYxFDASBgNVBAMM\n" \
    "C25yZjkxLW1hcnRlMCAXDTE5MDQwNTExMTUxN1oYDzQ3NTcwMzAyMTExNTE3WjAW\n" \
    "MRQwEgYDVQQDDAtucmY5MS1tYXJ0ZTBZMBMGByqGSM49AgEGCCqGSM49AwEHA0IA\n" \
    "BAq8otkWGnocpdAxlnpJdVn6EBb1WbQnZXLFaYzsMeXWGFIIO02hWTvaSUPI1xNs\n" \
    "0QB8c3IU9oBhDXkRNU2Nqi2jUDBOMB0GA1UdDgQWBBRLAhO335CAd280I/qVQmiM\n" \
    "07nd8TAfBgNVHSMEGDAWgBRLAhO335CAd280I/qVQmiM07nd8TAMBgNVHRMEBTAD\n" \
    "AQH/MAoGCCqGSM49BAMCA0gAMEUCIF2kQO7Cqn73ANmwBdgGA1y/KGOpOU4I/ywF\n" \
    "LEu8trOUAiEA8//UWttMRkmaylghw3mgsYGGKk17rY+4j+4mGUwvDnw=\n"         \
    "-----END CERTIFICATE-----"

#define GCLOUD_CA_CERTIFICATE ROOT_CERT

#define GCLOUD_ID                              \
    "projects/" CONFIG_GCLOUD_PROJECT_NAME     \
    "/locations/" CONFIG_GCLOUD_REGION         \
    "/registries/" CONFIG_GCLOUD_REGISTRY_NAME \
    "/devices/" CONFIG_GCLOUD_DEVICE_NAME

#define GCLOUD_HOSTNAME "mqtt.googleapis.com"
#define BROKER_ADDR GCLOUD_HOSTNAME
#define BROKER_PORT 8883

#define GCLOUD_SEC_TAG 16842753

#define SUBSCRIBE_ID 42

#define CLOUD_CONNACK_WAIT_DURATION K_SECONDS(CONFIG_CLOUD_WAIT_DURATION)
#define GCLOUD_DISCONNECT_INTERVAL K_HOURS(12)

#define GCLOUD_CONFIG_TOPIC "/devices/" CONFIG_GCLOUD_DEVICE_NAME "/config"
#define GCLOUD_STATE_TOPIC "/devices/" CONFIG_GCLOUD_DEVICE_NAME "/state"
#define GCLOUD_TOPIC "/devices/" CONFIG_GCLOUD_DEVICE_NAME "/events"

#define JWT_BUFFER_SIZE 256

#define GCLOUD_THREAD_STACK_SIZE 2048
#define GCLOUD_THREAD_PRIORITY 8
```

## include/ntp.h
```c
/*
 * Copyright (c) 2018 Nordic Semiconductor ASA
 *
 * SPDX-License-Identifier: LicenseRef-BSD-5-Clause-Nordic
 */

#ifndef _NTP_H_
#define _NTP_H_

#include <zephyr.h>
#include <net/socket.h>
#include <stdio.h>
#include <drivers/uart.h>
#include <string.h>
#include <time.h>
#include "ntp.h"

struct ntp_format
{
	u8_t flags;
	u8_t stratum;		/* stratum */
	u8_t poll;			/* poll interval */
	s8_t precision;		/* precision */
	u32_t rootdelay;	/* root delay */
	u32_t rootdisp;		/* root dispersion */
	u32_t refid;		/* reference ID */
	u32_t reftime_sec;  /* reference time */
	u32_t reftime_frac; /* reference time */
	u32_t org_sec;		/* origin timestamp */
	u32_t org_frac;		/* origin timestamp */
	u32_t rec_sec;		/* receive timestamp */
	u32_t rec_frac;		/* receive timestamp */
	u32_t xmt_sec;		/* transmit timestamp */
	u32_t xmt_frac;		/* transmit timestamp */
};

/**
 * @brief Receive data from a connected peer while blocking.
 * 
 * @note The recv() function is equivalent to recvfrom() with null pointer
 *       src_addr and addrlen arguments, and to read() if the socket
 *       argument refers to a socket and the flags argument is 0.
 * @note The select() and poll() functions can be used to determine when data
 *       is available to be received.
 * @note For a description of the flags parameter, see the full normative
 * 		 description at `POSIX.1-2017 article
 * 		 <http://pubs.opengroup.org/onlinepubs/9699919799/functions/recv.html>`
 * 
 * @param[in] fd Specifies the socket file descriptor.
 * @param[in] buf Points to a buffer where the message should be stored.
 * @param[in] size Specifies the length in bytes of the buffer pointed to by
 *            the buffer argument.
 * @param[in] flags Specifies the type of message reception.
 * 
 * @retval Upon successful completion, recv() shall return the length of the
 *         message in bytes. If no messages are available to be received and
 *         the peer has performed an orderly shutdown, recv() shall return 0.
 *         Otherwise, -1 shall be returned and errno set to indicate the error.
 */
int blocking_recv(int fd, u8_t *buf, u32_t size, u32_t flags);

/**
 * @brief Receive data from an arbitrary network address while blocking.
 * 
 * @note The select() and poll() functions can be used to determine when data
 *       is available to be received.
 * @note For a description of the flags parameter, see the full normative
 * 		 description at `POSIX.1-2017 article
 * 		 <http://pubs.opengroup.org/onlinepubs/9699919799/functions/recvfrom.html>`
 * 
 * @param[in] fd Specifies the socket file descriptor.
 * @param[in] buf Points to the buffer where the message should be stored.
 * @param[in] size Specifies the length in bytes of the buffer pointed to by
 *            the buffer argument.
 * @param[in] flags Specifies the type of message reception.
 * @param[in] src_addr A null pointer, or points to a sockaddr structure in
 *            which the sending address is to be stored. The length and format
 *            of the address depend on the address family of the socket.
 * @param[in] addrlen Either a null pointer, if address is a null pointer, or a
 *            pointer to a socklen_t object which on input specifies the length
 *            of the supplied sockaddr structure, and on output specifies the
 *            length of the stored address.
 * 
 * @retval Upon successful completion, recvfrom() shall return the length of
 *         the message in bytes. If no messages are available to be received
 *         and the peer has performed an orderly shutdown, recvfrom() shall
 *         return 0. Otherwise, the function shall return -1 and set errno to
 *         indicate the error.
 */
int blocking_recvfrom(int fd, void *buf, u32_t size, u32_t flags,
					  struct sockaddr *src_addr, socklen_t *addrlen);

/**
 * @brief Send data to a connected peer while blocking.
 * 
 * @note If the socket argument refers to a connection-mode socket, the send()
 *       function is equivalent to sendto() (with any value for the dest_addr
 *       and dest_len arguments, as they are ignored in this case). If the
 *       socket argument refers to a socket and the flags argument is 0, the
 *       send() function is equivalent to write().
 * @note For a description of the flags parameter, see the full normative
 * 		 description at `POSIX.1-2017 article
 * 		 <http://pubs.opengroup.org/onlinepubs/9699919799/functions/send.html>`
 * 
 * @param[in] fd Specifies the socket file descriptor.
 * @param[in] buf Points to the buffer containing the message to send.
 * @param[in] size Specifies the length of the message in bytes.
 * @param[in] flags Specifies the type of message transmission.
 * 
 * @retval Upon successful completion, send() shall return the number of bytes
 *         sent. Otherwise, -1 shall be returned and errno set to indicate the
 *         error.
 */
int blocking_send(int fd, u8_t *buf, u32_t size, u32_t flags);

/**
 * @brief Connect a socket to a peer network address while blocking.
 * 
 * @note If connect() fails, the state of the socket is unspecified. Conforming
 *       applications should close the file descriptor and create a new socket
 *       before attempting to reconnect.
 * @note For a description of the flags parameter, see the full normative
 * 		 description at `POSIX.1-2017 article
 * 		 <http://pubs.opengroup.org/onlinepubs/9699919799/functions/connect.html>`
 * 
 * @param[in] fd Specifies the file descriptor associated with the socket.
 * @param[in] local_addr Points to a sockaddr structure containing the peer
 *            address. The length and format of the address depend on the
 *            address family of the socket.
 * @param[in] len Specifies the length of the sockaddr structure pointed to by
 *            the address argument.
 * 
 * @retval Upon successful completion, connect() shall return 0; otherwise, -1
 *         shall be returned and errno set to indicate the error.
 */
int blocking_connect(int fd, struct sockaddr *local_addr, socklen_t len);

/**
 * @brief Convert NTP time values from host to network byte order.
 * 
 * @param[in] ntp Points to the ntp_format object to be converted.
 */
void ntp_swap_endianess(struct ntp_format *ntp);

/**
 * @brief Get Unix time from NTP server.
 * 
 * @note Only supports IPv4.
 * 
 * @retval Upon successful completion, returns Unix timestamp at the time that
 *         the server replied, in seconds. Otherwise, returns a negative error
 *         code indicating reason for failure.
 */
u32_t ntp_get_unix_time(void);

#endif /* _NTP_H_ */
```

## src/gcloud.c
```c
/*
 * Copyright (c) 2019 Nordic Semiconductor ASA
 *
 * SPDX-License-Identifier: LicenseRef-BSD-5-Clause-Nordic
 */

#include <logging/log.h>
LOG_MODULE_REGISTER(gcloud);

#include <zephyr.h>
#include <string.h>
#include <errno.h>
#include <random/rand32.h>

#include <net/socket.h>
#include <net/mqtt.h>

#include <data/jwt.h>
#include <modem/lte_lc.h>
#include <modem/modem_key_mgmt.h>

#include "gcloud.h"
//COMEBACK

#include "ntp.h"
#include "globalsign.inc"
#include "gcloud_defines.h"

/** MQTT and cloud specifics */

/* Buffers for MQTT client. */
static u8_t rx_buffer[CONFIG_MQTT_MESSAGE_BUFFER_SIZE];
static u8_t tx_buffer[CONFIG_MQTT_MESSAGE_BUFFER_SIZE];

enum gcloud_event_type
{
    CONNECT,
    INPUT_TIMEOUT,
    LIVE_TIMEOUT,
    PUBLISH_STATE,
    PUBLISH,
    RECONNECT_TIMEOUT,
    DISCONNECT,
    SUBSCRIBE
};

struct empty {};

union gcloud_event_param
{
    struct empty connect;
    //COMEBACK
    /*publish_state could be a whole MQTT message, thus allowing custom topics*/
    struct mqtt_publish_message publish_state;
    struct mqtt_publish_message publish;
    struct empty reconnect_timeout;
    struct empty disconnect;
    /* subscribe is a list of topics to be subscribed to */
    struct empty subscribe;
};

struct gcloud_event
{
    enum gcloud_event_type type;
    union gcloud_event_param param;
};

static struct mqtt_client client;
static struct sockaddr_storage mqtt_broker;
static struct mqtt_sec_config tls_config;

char jwt_buffer[JWT_BUFFER_SIZE];
static struct mqtt_utf8 jwt_token = {
    .utf8 = jwt_buffer};

static struct mqtt_utf8 username = {
    .utf8 = "unused",
    .size = sizeof("unused")};

static struct mqtt_topic gcloud_topics_list[] = {
    {.topic = {
         .utf8 = GCLOUD_CONFIG_TOPIC,
         .size = sizeof(GCLOUD_CONFIG_TOPIC) - 1},
     .qos = MQTT_QOS_0_AT_MOST_ONCE}};

/** Private key information */
extern unsigned char zepfull_private_der[];
extern unsigned int zepfull_private_der_len;

//COMEBACK

/** Error information */
enum error_type
{
    ERROR_CLOUD,
    ERROR_BSD_RECOVERABLE,
    ERROR_BSD_IRRECOVERABLE,
    ERROR_LTE_LC,
    ERROR_THREAD
};

/** Thread specifics */
K_THREAD_STACK_DEFINE(gcloud_stack_area, GCLOUD_THREAD_STACK_SIZE);
static void gcloud_thread(void *, void *, void *);

static struct k_thread gcloud_thread_data;
static k_tid_t gcloud_thread_tid;

/** Forward Declarations */
static void mqtt_event_handler(struct mqtt_client *client,
                               const struct mqtt_evt *evt);

static void reconnect_timer_handler(struct k_timer *timer_id);

K_TIMER_DEFINE(reconnect_timer, reconnect_timer_handler, NULL);

/** Global Variables */
atomic_t connected;
atomic_t connecting;

/** Function Declarations */

int gcloud_get_connection_status()
{
    return atomic_get(&connected);
}

static int make_jwt(char *buffer, size_t buffer_size)
{
    int err;
    struct jwt_builder jb;

    err = jwt_init_builder(&jb, buffer, buffer_size);
    if (err != 0)
    {
        LOG_ERR("Unable to init JWT builder: %d", err);
        return err;
    }

    s32_t timestamp = ntp_get_unix_time();
    if (timestamp < 0)
    {
        LOG_ERR("Unable to get Unix time: %d", err);
        return err;
    }

    err = jwt_add_payload(&jb, timestamp + 12 * 60 * 60, timestamp,
                          CONFIG_GCLOUD_PROJECT_NAME);
    if (err != 0)
    {
        LOG_ERR("Unable to add JWT payload: %d", err);
        return err;
    }

    err = jwt_sign(&jb, zepfull_private_der, zepfull_private_der_len);
    if (err != 0)
    {
        LOG_ERR("Unable to sign JWT token: %d", err);
        return err;
    }

    if (jb.overflowed != 0)
    {
        LOG_ERR("JWT buffer overflowed");
        return -ENOMEM;
    }
    return err;
}

static int gcloud_client_init(void)
{
    mqtt_client_init(&client);

    int err = make_jwt(jwt_buffer, JWT_BUFFER_SIZE);
    if (err != 0)
    {
        LOG_ERR("Unable to make jwt: %d %s", err, strerror(-err));
        return err;
    }

    LOG_DBG("JWT length: %d", strlen(jwt_buffer));

    jwt_token.size = strlen(jwt_buffer);

    client.evt_cb = mqtt_event_handler;
    client.client_id.utf8 = GCLOUD_ID;
    client.client_id.size = strlen(GCLOUD_ID);

    client.password = &jwt_token;
    client.user_name = &username;

    client.protocol_version = MQTT_VERSION_3_1_1;

    /* MQTT buffers configuration */
	client.rx_buf = rx_buffer;
    client.rx_buf_size = 512;
	client.tx_buf = tx_buffer;
    client.tx_buf_size = 1024;
    client.transport.type = MQTT_TRANSPORT_NON_SECURE;

    // //COMEBACK
    // struct mqtt_sec_config *client_tls_config = &client.transport.tls.config;
    // memcpy(client_tls_config, &tls_config, sizeof(struct mqtt_sec_config));
    // client.broker = (struct sockaddr *)&mqtt_broker;

    // static sec_tag_t sec_tag_list[] = { CONFIG_MQTT_TLS_SEC_TAG };

	// LOG_INF("TLS enabled");
	// client->transport.type = MQTT_TRANSPORT_SECURE;

	// tls_cfg->peer_verify = CONFIG_MQTT_TLS_PEER_VERIFY;
	// tls_cfg->cipher_count = 0;
	// tls_cfg->cipher_list = NULL;
	// tls_cfg->sec_tag_count = ARRAY_SIZE(sec_tag_list);
	// tls_cfg->sec_tag_list = sec_tag_list;
	// tls_cfg->hostname = CONFIG_MQTT_BROKER_HOSTNAME;

    return 0;
}

static int gcloud_subscribe()
{
    const struct mqtt_subscription_list subscriptions = {
        .list = (struct mqtt_topic *)&gcloud_topics_list,
        .list_count = ARRAY_SIZE(gcloud_topics_list),
        .message_id = SUBSCRIBE_ID};

    return mqtt_subscribe(&client, &subscriptions);
}

int gcloud_provision(void)
{
    static sec_tag_t sec_tag_list[] = {GCLOUD_SEC_TAG};

    tls_config.peer_verify = 0;
    tls_config.cipher_count = 0;
    tls_config.cipher_list = NULL;
    tls_config.sec_tag_count = ARRAY_SIZE(sec_tag_list);
    tls_config.sec_tag_list = sec_tag_list;
    tls_config.hostname = GCLOUD_HOSTNAME;

    int err = 0;

    /* Delete certificates with sec_tag GCLOUD_SEC_TAG*/
    nrf_sec_tag_t sec_tag = GCLOUD_SEC_TAG;

    // for (modem_key_mgnt_cred_type type = 0; type < 5; type++)
    // {
    //     modem_key_mgmt_delete(sec_tag, type);
    // }
    /* Provision CA Certificate */
    err = modem_key_mgmt_write(
        GCLOUD_SEC_TAG,
        MODEM_KEY_MGMT_CRED_TYPE_CA_CHAIN,
        GCLOUD_CA_CERTIFICATE,
        strlen(GCLOUD_CA_CERTIFICATE));
    if (err != 0)
    {
        LOG_ERR("GCLOUD_CA_CERTIFICATE err: %d %s\n", err, strerror(err));
        return err;
    }

    return err;
}

//COMEBACK, CHECK CB
void gcloud_connect(void)
{
    LOG_DBG("Initiating broker");
    int err;
    struct addrinfo *result;
    struct addrinfo *addr;
    struct addrinfo hints = {
        .ai_family = AF_INET,
        .ai_socktype = SOCK_STREAM};

    err = getaddrinfo(GCLOUD_HOSTNAME, NULL, &hints, &result);
    if (err)
    {
        LOG_ERR("ERROR: getaddrinfo failed %d", err);

        return;
    }

    addr = result;
    err = -ENOENT;

    /* Look for address of the broker. */
    while (addr != NULL)
    {
        /* IPv4 Address. */
        if (addr->ai_addrlen == sizeof(struct sockaddr_in))
        {
            struct sockaddr_in *broker4 =
                ((struct sockaddr_in *)&mqtt_broker);
            broker4->sin_addr.s_addr =
                ((struct sockaddr_in *)addr->ai_addr)
                    ->sin_addr.s_addr;
            broker4->sin_family = AF_INET;
            broker4->sin_port = htons(BROKER_PORT);
            LOG_DBG("IPv4 Address found 0x%08x",
                    broker4->sin_addr.s_addr);

            LOG_DBG("Initiating client");
            err = gcloud_client_init();
            if (err)
            {
                LOG_ERR("Could not initiate client: %d %s", err, strerror(-err));
            }

            LOG_DBG("Connecting mqtt");
            atomic_set(&connecting, 1);
            err = mqtt_connect(&client);
            if (err)
            {
                LOG_ERR("mqtt_connect failed: %d %s", err, strerror(-err));
            }
            break;
        }
        else
        {
            LOG_ERR("ai_addrlen = %u should be %u or %u",
                    (unsigned int)addr->ai_addrlen,
                    (unsigned int)sizeof(struct sockaddr_in),
                    (unsigned int)sizeof(struct sockaddr_in6));
        }

        addr = addr->ai_next;
        break;
    }

    /* Free the address. */
    freeaddrinfo(result);
}

int gcloud_disconnect(bool RECONNECT)
{
    ARG_UNUSED(RECONNECT);

    int err = 0;
    k_timer_stop(&reconnect_timer);
    LOG_DBG("Disconnecting MQTT");
    err = mqtt_disconnect(&client);
    if (err)
    {
        LOG_ERR("mqtt_disconnect failed: %d", err);
    }
    atomic_set(&connected, 0);
    return err;
}

int gcloud_publish(u8_t *data, u32_t size, enum mqtt_qos qos)
{
    LOG_INF("Publishing data to Google Cloud");
    int err;
    if (!atomic_get(&connected))
    {
        LOG_WRN("Cannot publish data while not connected to Google Cloud");
        return -ENOTCONN;
    }

    struct mqtt_publish_param msg;

    struct mqtt_publish_message temp = {
        .topic = {
            .topic = {
                .utf8 = GCLOUD_TOPIC,
                .size = strlen(GCLOUD_TOPIC)},
            .qos = qos},
        .payload = {.data = data, .len = size}};
    msg.message = temp;
    msg.message_id = sys_rand32_get();
    msg.dup_flag = 0;
    msg.retain_flag = 0;
    err = mqtt_publish(&client, &msg);
    if (err)
    {
        LOG_ERR("mqtt_publish (gps) failed: %d", err);
    }

    return err;
}

int gcloud_publish_state(u8_t *data, u32_t size, enum mqtt_qos qos)
{
    LOG_INF("Publishing state to Google Cloud");
    int err;
    if (!atomic_get(&connected))
    {
        LOG_WRN("Cannot publish state while not connected to Google Cloud");
        return -ENOTCONN;
    }

    struct mqtt_publish_param msg;

    struct mqtt_publish_message temp = {
        .topic = {
            .topic = {
                .utf8 = GCLOUD_STATE_TOPIC,
                .size = strlen(GCLOUD_STATE_TOPIC)},
            .qos = qos},
        .payload = {.data = data, .len = size}};
    msg.message = temp;
    msg.message_id = sys_rand32_get();
    msg.dup_flag = 0;
    msg.retain_flag = 0;
    err = mqtt_publish(&client, &msg);

    if (err)
    {
        LOG_ERR("mqtt_publish (state) failed: %d", err);
    }
    return err;
}

void reconnect_timer_handler(struct k_timer *timer_id)
{
    gcloud_disconnect(true);
}

void gcloud_start_thread(void)
{
    gcloud_thread_tid =
        k_thread_create(&gcloud_thread_data,
                        gcloud_stack_area,
                        K_THREAD_STACK_SIZEOF(gcloud_stack_area),
                        gcloud_thread,
                        NULL, NULL, NULL,
                        GCLOUD_THREAD_PRIORITY, 0, K_NO_WAIT);
}

void gcloud_ping(void)
{
    int err;
    err = mqtt_live(&client);
    if (err)
    {
        LOG_ERR("Error: MQTT live failed %d %s", err, strerror(err));
    }
}

void gcloud_process(void)
{
    int err;
    err = mqtt_input(&client);
    if (err)
    {
        LOG_ERR("Error: MQTT input failed %d %s", err, strerror(err));
    }

    err = mqtt_live(&client);
    if (err)
    {
        LOG_ERR("Error: MQTT live (process) failed %d %s",
                err, strerror(err));
    }
}

static void mqtt_event_handler(struct mqtt_client *client,
                               const struct mqtt_evt *evt)
{
    int err;
    LOG_DBG("MQTT event: %d", evt->type);

    switch (evt->type)
    {

    /* Response to connack request */
    case MQTT_EVT_CONNACK:
        LOG_DBG("MQTT CONNACK");
        LOG_INF("Connected to Google Cloud");
        if (evt->result != 0)
        {
            LOG_ERR("MQTT connect failed: %d %s", evt->result,
                    strerror(evt->result));
            break;
        }

        if (evt->param.connack.return_code != MQTT_CONNECTION_ACCEPTED)
        {
            LOG_ERR("CONNACK ERROR. Return Code: %d", evt->param.connack.return_code);
        }

        atomic_set(&connected, 1);
        atomic_set(&connecting, 0);
        k_timer_start(&reconnect_timer, GCLOUD_DISCONNECT_INTERVAL,
                      GCLOUD_DISCONNECT_INTERVAL);

        LOG_DBG("SUBSCRIBING");
        err = gcloud_subscribe();
        if (err)
        {
            LOG_ERR("gcloud_subscribe failed: %d",
                    err);
        }
        break;

    /* A message has been published on a topic we subscribe to. */
    case MQTT_EVT_PUBLISH:
        LOG_DBG("MQTT PUBLISH");
        LOG_INF("Received a message from Google Cloud");
        if (evt->result != 0)
        {
            LOG_ERR("Publish event error: %d %s", evt->result,
                    strerror(-evt->result));
        }

        if (evt->param.publish.message.topic.qos == MQTT_QOS_1_AT_LEAST_ONCE)
        {
            const struct mqtt_puback_param ack = {
                .message_id = evt->param.publish.message_id};

            /* Send acknowledgement. */
            err = mqtt_publish_qos1_ack(client, &ack);
            if (err)
            {
                LOG_ERR("Publish acknowledgement error %d %s", err, strerror(err));
            }
            LOG_DBG("MSG ACKNOWLEDGED");
        }

        if ((evt->param.publish.message.payload.data == NULL) ||
            (evt->param.publish.message.payload.len <= 2))
        {
            LOG_WRN("Received an empty message");
            break;
        }

        LOG_DBG("Length of payload: %d", evt->param.publish.message.payload.len);
        LOG_DBG("Topic: %s", log_strdup(evt->param.publish.message.topic.topic.utf8));
        LOG_DBG("QoS: %d", evt->param.publish.message.topic.qos);
        LOG_DBG("Message:\n%s\n", log_strdup(evt->param.publish.message.payload.data));

        struct mqtt_evt event = *evt;

        char *str = calloc(evt->param.publish.message.payload.len, sizeof(char) + 1);
        memcpy(str, evt->param.publish.message.payload.data, evt->param.publish.message.payload.len);
        event.param.publish.message.payload.data = str;
        //COMEBACK
        // path_module_received_path_handler(&event.param.publish.message);

        free(str);
        break;

    /* Disconnect event. MQTT Client Reference is no longer valid. */
    case MQTT_EVT_DISCONNECT:
        LOG_DBG("MQTT DISCONNECT");
        LOG_INF("MQTT client disconnected: %d %s", evt->result, strerror(-evt->result));
        k_timer_stop(&reconnect_timer);

        break;

    /* Acknowledgement for QoS 1 messages. */
    case MQTT_EVT_PUBACK:
        LOG_DBG("MQTT PUBACK");
        if (evt->result != 0)
        {
            LOG_ERR("MQTT PUBACK error: %d", evt->result);
            break;
        }

        LOG_DBG("PUBACK packet id: %d\n", evt->param.puback.message_id);

        break;

    /* Reception confirmation for messages with QoS 2. */
    case MQTT_EVT_PUBREC:
        LOG_DBG("MQTT PUBREC");
        if (evt->result != 0)
        {
            LOG_ERR("MQTT PUBREC error: %d", evt->result);
            break;
        }

        LOG_DBG("PUBREC packet id: %u", evt->param.pubrec.message_id);

        const struct mqtt_pubrel_param rel_param = {
            .message_id = evt->param.pubrec.message_id};

        err = mqtt_publish_qos2_release(client, &rel_param);
        if (err != 0)
        {
            LOG_ERR("Failed to send MQTT PUBREL: %d", err);
        }

        break;

    /* Release of messages with QoS 2. */
    case MQTT_EVT_PUBREL:
        LOG_DBG("MQTT PUBREL");
        if (evt->result != 0)
        {
            LOG_ERR("PUBREL error: %d", evt->result);
            break;
        }
        break;

    /* Confirmation to publish */
    case MQTT_EVT_PUBCOMP:
        if (evt->result != 0)
        {
            LOG_ERR("MQTT PUBCOMP error: %d", evt->result);
            break;
        }

        LOG_DBG("PUBCOMP packet id: %u", evt->param.pubcomp.message_id);
        break;

    /* Acknowledgment of a subscription request. */
    case MQTT_EVT_SUBACK:
        LOG_DBG("MQTT SUBACK");
        if (evt->result != 0)
        {
            LOG_ERR("MQTT SUBACK error: %d", evt->result);
            break;
        }
        switch (*evt->param.suback.return_codes.data)
        {

        /* Subscription with QoS 0 succeeded. */
        case MQTT_SUBACK_SUCCESS_QoS_0:
            LOG_INF("Subscribed with QoS 0");
            break;

        /* Subscription with QoS 1 succeeded. */
        case MQTT_SUBACK_SUCCESS_QoS_1:
            LOG_INF("Subscribed with QoS 1");
            break;

        /* Subscription with QoS 2 succeeded. */
        case MQTT_SUBACK_SUCCESS_QoS_2:
            LOG_INF("Subscribed with QoS 2");
            break;

        /* Subscription for a topic failed. */
        case MQTT_SUBACK_FAILURE:
            LOG_ERR("SUBACK FAILURE");
            break;

        default:
            LOG_ERR("Unknown suback return code");
            break;
        }

        break;

    /* Acknowledgment of a unsubscribe request. */
    case MQTT_EVT_UNSUBACK:
        LOG_DBG("MQTT UNSUBACK");
        if (evt->result != 0)
        {
            LOG_ERR("MQTT UNSUBACK error: %d", evt->result);
            break;
        }

        break;

    default:
        LOG_ERR("Unknown mqtt event type");
        break;
    }
}

void gcloud_thread(void *unused1, void *unused2, void *unused3)
{
    int ret;
    k_timer_init(&reconnect_timer, reconnect_timer_handler, NULL);

    gcloud_connect();

    /* Waiting for client socket to be initialized */
    for (int i = 200;
         (!atomic_get(&connecting)) && (!atomic_get(&connected)) && (i > 0); i--)
    {
        k_sleep(K_MSEC(50));
    }

    struct pollfd fds[] = {
        {.fd = client.transport.tcp.sock,
         .events = POLLIN}};

    while (true)
    {
        ret = poll(fds, ARRAY_SIZE(fds),
                   mqtt_keepalive_time_left(&client));

        if (ret < 0)
        {
            LOG_ERR("poll() returned an error: %d", ret);
            continue;
        }

        if (ret == 0)
        {
            LOG_DBG("GCLOUD: ping");
            gcloud_ping();
            continue;
        }

        if ((fds[0].revents & POLLIN) == POLLIN)
        {
            LOG_DBG("GCLOUD: process");
            gcloud_process();
        }

        if ((fds[0].revents & POLLNVAL) == POLLNVAL)
        {
            LOG_ERR("Socket error: POLLNVAL");
            return;
        }

        if ((fds[0].revents & POLLHUP) == POLLHUP)
        {
            LOG_ERR("Socket error: POLLHUP");
            return;
        }

        if ((fds[0].revents & POLLERR) == POLLERR)
        {
            LOG_ERR("Socket error: POLLERR");
            return;
        }
    }
}
```

## src/ntp.c
```c
/*
 * Copyright (c) 2018 Nordic Semiconductor ASA
 *
 * SPDX-License-Identifier: LicenseRef-BSD-5-Clause-Nordic
 */

#include <zephyr.h>
#include <net/socket.h>
#include <stdio.h>
#include <drivers/uart.h>
#include <string.h>
#include <time.h>
#include "ntp.h"

#define NTP_HOST "ntp.uio.no"
#define NTP_PORT 123
#define RECV_BUF_SIZE 1024

/* Chapter 3: https://www.eecis.udel.edu/~mills/y2k.html 
 * Need to convert from 1900 -> 1970
 */
#define NTP_TO_UNIX_OFFSET 2208988800ULL

char recv_buf[RECV_BUF_SIZE];

int blocking_recv(int fd, u8_t *buf, u32_t size, u32_t flags)
{
	int err;

	do
	{
		err = recv(fd, buf, size, flags);
	} while (err < 0 && errno == EAGAIN);

	return err;
}

int blocking_recvfrom(int fd, void *buf, u32_t size, u32_t flags,
					  struct sockaddr *src_addr, socklen_t *addrlen)
{
	int err;

	do
	{
		err = recvfrom(fd, buf, size, flags, src_addr, addrlen);
	} while (err < 0 && errno == EAGAIN);

	return err;
}

int blocking_send(int fd, u8_t *buf, u32_t size, u32_t flags)
{
	int err;

	do
	{
		err = send(fd, buf, size, flags);
	} while (err < 0 && errno == EAGAIN);

	return err;
}

int blocking_connect(int fd, struct sockaddr *local_addr, socklen_t len)
{
	int err;

	do
	{
		err = connect(fd, local_addr, len);
	} while (err < 0 && errno == EAGAIN);

	return err;
}

void ntp_swap_endianess(struct ntp_format *ntp)
{
	if (ntp)
	{
		ntp->org_frac = htonl(ntp->org_frac);
		ntp->org_sec = htonl(ntp->org_sec);
		ntp->reftime_frac = htonl(ntp->reftime_frac);
		ntp->reftime_sec = htonl(ntp->reftime_sec);
		ntp->rec_frac = htonl(ntp->rec_frac);
		ntp->rec_sec = htonl(ntp->rec_sec);
		ntp->xmt_frac = htonl(ntp->xmt_frac);
		ntp->xmt_sec = htonl(ntp->xmt_sec);
	}
}

u32_t ntp_get_unix_time(void)
{
	struct addrinfo *res;
	struct addrinfo hints = {
		.ai_family = AF_INET,
		.ai_socktype = SOCK_DGRAM};
	struct ntp_format ntp = {0};
	socklen_t addrlen = sizeof(struct sockaddr_storage);

	ntp.flags = 0xe3;
	int err = getaddrinfo(NTP_HOST, NULL, &hints, &res);
	if (err < 0)
	{
		printk("getaddrinfo err: %d %s\n", err, strerror(err));
		return err;
	}

	((struct sockaddr_in *)res->ai_addr)->sin_port = htons(NTP_PORT);
	struct sockaddr_in local_addr;

	local_addr.sin_family = AF_INET;
	local_addr.sin_port = htons(0);
	local_addr.sin_addr.s_addr = 0;

	int client_fd = socket(AF_INET, SOCK_DGRAM, 0);

	err = bind(client_fd, (struct sockaddr *)&local_addr,
			   sizeof(local_addr));
	if (err < 0)
	{
		printk("bind err: %d %s\n", err, strerror(err));
		return err;
	}

	err = blocking_connect(client_fd, (struct sockaddr *)res->ai_addr,
						   sizeof(struct sockaddr_in));
	if (err < 0)
	{
		printk("connect err: %d %s\n", err, strerror(err));
		return err;
	}

	err = send(client_fd, &ntp, sizeof(struct ntp_format), 0);
	if (err < 0)
	{
		printk("sendto err: %d %s\n", err, strerror(err));
		return err;
	}

	err = blocking_recvfrom(client_fd, &ntp, sizeof(struct ntp_format), 0,
							(struct sockaddr *)res->ai_addr, &addrlen);
	if (err < 0)
	{
		printk("recvfrom err: %d %s\n", err, strerror(err));
		return err;
	}

	ntp_swap_endianess(&ntp);

	u32_t unix_time = ntp.xmt_sec - NTP_TO_UNIX_OFFSET;

	(void)close(client_fd);
	return unix_time;
}
```
